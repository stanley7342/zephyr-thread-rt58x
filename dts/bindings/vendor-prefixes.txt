## soc/arm/rafael_micro/Kconfig.series
```kconfig
config SOC_SERIES_RT583
    bool "Rafael Microelectronics RT583 series"
    select CPU_CORTEX_M3
    help
      RT583/RT581/RT583 SoCs based on ARM Cortex-M3.

config SOC_SERIES_RT584
    bool "Rafael Microelectronics RT584 series"
    select CPU_CORTEX_M33
    help
      RT584/RT584H/RT584L SoCs based on ARM Cortex-M33 (ARMv8-M Mainline).
```

## soc/arm/rafael_micro/rt582/Kconfig
```kconfig
# Rafael RT582 SoC Kconfig

config SOC_SERIES_RT582
    select ARM
    select CPU_CORTEX_M3
    select CPU_HAS_ARM_MPU   # RT582 mcu.h: __MPU_PRESENT = 1

config SOC_RT582
    bool
    select SOC_SERIES_RT582

config SOC_SERIES
    default "rt582" if SOC_SERIES_RT582

config SOC
    default "rt582" if SOC_RT582
```

## soc/arm/rafael_micro/rt582/Kconfig.defconfig
```kconfig
if SOC_RT582

# RT582 clock: librt582_system.a compiled with SET_SYS_CLK=2 (SYS_CLK_64MHZ)
config SYS_CLOCK_HW_CYCLES_PER_SEC
    default 64000000

# RT582 external IRQs: 0–32 (Comp_IRQn = 32 is the highest in mcu.h)
config NUM_IRQS
    default 33

endif # SOC_RT582
```

## soc/arm/rafael_micro/rt582/Kconfig.soc
```kconfig
config SOC_SERIES_RT582
    bool
    select SOC_FAMILY_ARM

config SOC_RT582
    bool
    select SOC_SERIES_RT582

config SOC_SERIES
    default "rt582" if SOC_SERIES_RT582

config SOC
    default "rt582" if SOC_RT582
```

## soc/arm/rafael_micro/rt583/Kconfig
```kconfig
# Rafael RT583 SoC Kconfig

config SOC_SERIES_RT583
    select ARM
    select CPU_CORTEX_M3
    select CPU_HAS_ARM_MPU   # RT583 mcu.h: __MPU_PRESENT = 1

config SOC_RT583
    bool
    select SOC_SERIES_RT583

config SOC_SERIES
    default "rt583" if SOC_SERIES_RT583

config SOC
    default "rt583" if SOC_RT583
```

## soc/arm/rafael_micro/rt583/Kconfig.defconfig
```kconfig
if SOC_RT583

# RT583 clock: librt583_system.a compiled with SET_SYS_CLK=2 (SYS_CLK_64MHZ)
config SYS_CLOCK_HW_CYCLES_PER_SEC
    default 64000000

# RT583 external IRQs: 0–32 (Comp_IRQn = 32 is the highest in mcu.h)
config NUM_IRQS
    default 33

endif # SOC_RT583
```

## soc/arm/rafael_micro/rt583/Kconfig.soc
```kconfig
config SOC_SERIES_RT583
    bool
    select SOC_FAMILY_ARM

config SOC_RT583
    bool
    select SOC_SERIES_RT583

config SOC_SERIES
    default "rt583" if SOC_SERIES_RT583

config SOC
    default "rt583" if SOC_RT583
```

## soc/arm/rafael_micro/rt584/Kconfig
```kconfig
# Rafael RT584 SoC Kconfig (Cortex-M33, ARMv8-M Mainline)

config SOC_SERIES_RT584
    select ARM
    select CPU_CORTEX_M33
    select CPU_HAS_ARM_MPU       # RT584 mcu.h: __MPU_PRESENT = 1
    select CPU_HAS_ARM_SAU       # __SAUREGION_PRESENT = 1
    select CPU_HAS_FPU           # __FPU_PRESENT = 1 (CMSIS asserts)
    select ARMV8_M_MAINLINE
    select ARMV8_M_DSP           # __DSP_PRESENT = 1

config SOC_RT584
    bool
    select SOC_SERIES_RT584

config SOC_SERIES
    default "rt584" if SOC_SERIES_RT584

config SOC
    default "rt584" if SOC_RT584
```

## soc/arm/rafael_micro/rt584/Kconfig.defconfig
```kconfig
if SOC_RT584

# Enable Zephyr's earliest SoC hook so we can run bare-metal UART
# diagnostics at the very start of z_prep_c — before .bss zero, .data
# copy, FPU init, and interrupt setup. If [PREP] doesn't appear, the
# fault is in z_arm_reset / vector load / hardware boot. If [PREP] does
# appear but [BOOT] (later SYS_INIT) doesn't, fault is in core Zephyr
# init.
config SOC_PREP_HOOK
    default y

# CM33 with TrustZone: MSPLIM / PSPLIM may be at a non-zero reset value
# (depending on chip-specific reset behavior). Without this, Zephyr's
# z_arm_reset doesn't clear them and the first push during reset can
# trigger a stack-limit UsageFault — silent boot hang. Upstream's
# Reset_Handler does __set_MSPLIM/__set_PSPLIM to clear them; we need
# the equivalent.
config INIT_ARCH_HW_AT_BOOT
    default y


# RT584 clock: SystemInit + change_ahb_system_clk(SYS_64MHZ_CLK) in rt584 soc.c
config SYS_CLOCK_HW_CYCLES_PER_SEC
    default 64000000

# RT584 external IRQs: 0–47 (Aux_Comp_IRQn = 47 is the highest in mcu.h)
config NUM_IRQS
    default 48

endif # SOC_RT584
```

## soc/arm/rafael_micro/rt584/Kconfig.soc
```kconfig
config SOC_SERIES_RT584
    bool
    select SOC_FAMILY_ARM

config SOC_RT584
    bool
    select SOC_SERIES_RT584

config SOC_SERIES
    default "rt584" if SOC_SERIES_RT584

config SOC
    default "rt584" if SOC_RT584
```

## subsys/openthread/Kconfig
```kconfig
config OPENTHREAD_RT582
    bool "OpenThread for Rafael RT582"
    depends on SOC_RT582
    help
      Enables the OpenThread stack on the RT582 SoC.
      Links the pre-built Rafael SDK OpenThread FTD library and the
      RT582-specific Zephyr platform layer (replaces FreeRTOS with
      Zephyr kernel primitives).
```

## subsys/ota/Kconfig
```kconfig
config OTA
    bool "OTA firmware update subsystem"
    depends on FLASH && FLASH_MAP && BOOTLOADER_MCUBOOT
    depends on OPENTHREAD_RT582
    depends on SETTINGS
    help
      Enables CoAP Block-wise OTA download + LZ4 decompression
      to the secondary MCUboot slot.

if OTA

config OTA_LZ4_BLOCK_SZ
    int "LZ4 block size (bytes)"
    default 4096
    range 1024 8192
    help
      Compressed and decompressed block size. Must match the value
      used by ota_pack.py on the server side. Larger blocks improve
      compression ratio but use more RAM.

config OTA_CURRENT_VERSION_MAJOR
    int "Current image major version"
    default 1

config OTA_CURRENT_VERSION_MINOR
    int "Current image minor version"
    default 0

config OTA_CURRENT_VERSION_PATCH
    int "Current image patch version"
    default 0

config OTA_COAP_PORT
    int "OTA server CoAP port"
    default 5683

config OTA_APPLY_THREAD_STACK_SIZE
    int "OTA apply thread stack size"
    default 4096
    help
      Stack for the thread that runs ota_flash_apply().
      Must accommodate LZ4 + mbedTLS SHA-256.

endif # OTA
```
