## CMakeLists.txt
```
cmake_minimum_required(VERSION 3.20.0)

# ── Path setup ──────────────────────────────────────────────────────────────
# RT583_PROJECT_DIR: three levels up from this file (examples/matter/lighting-app → repo root)
get_filename_component(RT583_PROJECT_DIR "${CMAKE_CURRENT_LIST_DIR}/../../.." ABSOLUTE)
# Workspace root is one level above the repo (standard west workspace layout)
get_filename_component(WORKSPACE_DIR "${RT583_PROJECT_DIR}/.." ABSOLUTE)

# CHIP_ROOT: use CHIP_ROOT env var first, then search common locations.
# install.ps1 may place connectedhomeip either at:
#   <workspace>/connectedhomeip  (standard west layout — workspace is parent of repo)
#   <repo>/connectedhomeip       (install ran from inside the repo dir)
if(DEFINED ENV{CHIP_ROOT})
    get_filename_component(CHIP_ROOT "$ENV{CHIP_ROOT}" ABSOLUTE)
elseif(EXISTS "${WORKSPACE_DIR}/connectedhomeip/src/lib/core/CHIPError.h")
    set(CHIP_ROOT "${WORKSPACE_DIR}/connectedhomeip")
elseif(EXISTS "${RT583_PROJECT_DIR}/connectedhomeip/src/lib/core/CHIPError.h")
    set(CHIP_ROOT "${RT583_PROJECT_DIR}/connectedhomeip")
else()
    set(CHIP_ROOT "${WORKSPACE_DIR}/connectedhomeip")
endif()

if(NOT EXISTS "${CHIP_ROOT}/src/lib/core/CHIPError.h")
    message(FATAL_ERROR
        "connectedhomeip not found.\n"
        "Set the CHIP_ROOT environment variable or clone it:\n"
        "  git clone --depth=1 https://github.com/project-chip/connectedhomeip ${WORKSPACE_DIR}/connectedhomeip\n"
        "  cd ${WORKSPACE_DIR}/connectedhomeip && git fetch --depth=1 origin fdb31dbcb3ebe000ad3e41b386e90849937948f9 && git checkout fdb31dbcb3ebe000ad3e41b386e90849937948f9")
endif()

# ── Python3: prefer the workspace venv so codegen deps (python_path, matter IDL)
#    are available.  chip_codegen.cmake calls find_package(Python3) which would
#    otherwise pick the system Python that lacks these packages.
#
#    NOTE: under `west build --sysbuild` the child Zephyr project is launched by
#    ExternalZephyrProject_Cmake which does NOT inherit VIRTUAL_ENV, so the
#    VIRTUAL_ENV check alone isn't enough.  Fall back to the canonical
#    `<workspace>/.zephyr-venv` path that install.ps1 / install.sh create.
if(NOT DEFINED Python3_EXECUTABLE)
    if(WIN32)
        set(_rt583_venv_py_env  "$ENV{VIRTUAL_ENV}/Scripts/python.exe")
        set(_rt583_venv_py_ws   "${WORKSPACE_DIR}/.zephyr-venv/Scripts/python.exe")
    else()
        set(_rt583_venv_py_env  "$ENV{VIRTUAL_ENV}/bin/python")
        set(_rt583_venv_py_ws   "${WORKSPACE_DIR}/.zephyr-venv/bin/python")
    endif()

    if(DEFINED ENV{VIRTUAL_ENV} AND EXISTS "${_rt583_venv_py_env}")
        set(Python3_EXECUTABLE "${_rt583_venv_py_env}" CACHE FILEPATH "")
    elseif(EXISTS "${_rt583_venv_py_ws}")
        set(Python3_EXECUTABLE "${_rt583_venv_py_ws}" CACHE FILEPATH "")
    endif()
endif()

get_filename_component(GEN_DIR "${CHIP_ROOT}/zzz_generated" ABSOLUTE)

# ── Zephyr module setup ──────────────────────────────────────────────────────
set(BOARD_ROOT   ${RT583_PROJECT_DIR})
set(SOC_ROOT     ${RT583_PROJECT_DIR})
set(DTS_ROOT     ${RT583_PROJECT_DIR})
set(KCONFIG_ROOT ${RT583_PROJECT_DIR}/Kconfig)

list(APPEND ZEPHYR_EXTRA_MODULES ${RT583_PROJECT_DIR})

# Matter chip-module (nrfconnect variant — most complete Zephyr BT+OpenThread support)
list(APPEND ZEPHYR_EXTRA_MODULES ${CHIP_ROOT}/config/zephyr/chip-module)

# ── mbedTLS 4.0 compat shims (generated in build dir) ───────────────────────
# Zephyr v4.4 ships mbedTLS 4.0 (TF-PSA-Crypto) which moved public mbedtls/
# ecp.h, bignum.h, and pk.h APIs into private headers and redesigned
# mbedtls_pk_context.  connectedhomeip still uses the 3.x public API.
#
# Instead of committing shim files to the source tree, generate them at
# CMake configure time into ${CMAKE_BINARY_DIR}/chip_mbedtls_compat/ so the
# source tree stays clean.  The generated directory is prepended to the GN
# -I path so the shim headers shadow the installed public headers.
#
# Plain -I flags are used (not -isystem) because on Windows arm-zephyr-eabi-
# g++ mis-parses "-isystemC:/path" (drive letter consumed by flag name).
get_filename_component(TF_PSA_CRYPTO_INCLUDE
    "$ENV{ZEPHYR_BASE}/../modules/crypto/mbedtls/tf-psa-crypto/include"
    ABSOLUTE)
get_filename_component(TF_PSA_CRYPTO_BUILTIN_INCLUDE
    "$ENV{ZEPHYR_BASE}/../modules/crypto/mbedtls/tf-psa-crypto/drivers/builtin/include"
    ABSOLUTE)

set(_CHIP_MBEDTLS_COMPAT "${CMAKE_BINARY_DIR}/chip_mbedtls_compat")

# ecp.h — redirect to private header (ECP API moved in 4.x)
file(WRITE "${_CHIP_MBEDTLS_COMPAT}/mbedtls/ecp.h"
[=[/* Auto-generated compat shim — do not edit. */
#pragma once
#include <mbedtls/private/ecp.h>
]=])

# bignum.h — redirect to private header (bignum API moved in 4.x)
file(WRITE "${_CHIP_MBEDTLS_COMPAT}/mbedtls/bignum.h"
[=[/* Auto-generated compat shim — do not edit. */
#pragma once
#include <mbedtls/private/bignum.h>
]=])

# pk.h — (a) pulls in pk_private.h for legacy PK type symbols, and
#         (b) provides mbedtls_pk_ec() which was removed in 4.x.
#
# mbedtls_pk_context in 4.x is PSA-backed: the public key lives in
# pub_raw[] (uncompressed point bytes) and ec_family/bits describe the
# curve.  mbedtls_pk_ec() rebuilds an mbedtls_ecp_keypair from those
# fields using a static local (safe: connectedhomeip only reads the result).
file(WRITE "${_CHIP_MBEDTLS_COMPAT}/mbedtls/pk.h"
[=[/* Auto-generated compat shim — do not edit. */
#ifndef MBEDTLS_PK_SHIM_H
#define MBEDTLS_PK_SHIM_H

#include_next <mbedtls/pk.h>
#include <mbedtls/private/pk_private.h>
#include <mbedtls/private/ecp.h>

#ifdef __cplusplus
extern "C" {
#endif

static inline mbedtls_ecp_group_id mbedtls_pk_ec_psa_to_grp(
        psa_ecc_family_t family, size_t bits)
{
    switch (family) {
        case PSA_ECC_FAMILY_SECP_R1:
            switch (bits) {
#if defined(MBEDTLS_ECP_DP_SECP192R1_ENABLED)
                case 192: return MBEDTLS_ECP_DP_SECP192R1;
#endif
#if defined(MBEDTLS_ECP_DP_SECP224R1_ENABLED)
                case 224: return MBEDTLS_ECP_DP_SECP224R1;
#endif
#if defined(MBEDTLS_ECP_DP_SECP256R1_ENABLED)
                case 256: return MBEDTLS_ECP_DP_SECP256R1;
#endif
#if defined(MBEDTLS_ECP_DP_SECP384R1_ENABLED)
                case 384: return MBEDTLS_ECP_DP_SECP384R1;
#endif
#if defined(MBEDTLS_ECP_DP_SECP521R1_ENABLED)
                case 521: return MBEDTLS_ECP_DP_SECP521R1;
#endif
                default:  return MBEDTLS_ECP_DP_NONE;
            }
        case PSA_ECC_FAMILY_SECP_K1:
            switch (bits) {
#if defined(MBEDTLS_ECP_DP_SECP192K1_ENABLED)
                case 192: return MBEDTLS_ECP_DP_SECP192K1;
#endif
#if defined(MBEDTLS_ECP_DP_SECP224K1_ENABLED)
                case 224: return MBEDTLS_ECP_DP_SECP224K1;
#endif
#if defined(MBEDTLS_ECP_DP_SECP256K1_ENABLED)
                case 256: return MBEDTLS_ECP_DP_SECP256K1;
#endif
                default:  return MBEDTLS_ECP_DP_NONE;
            }
        case PSA_ECC_FAMILY_BRAINPOOL_P_R1:
            switch (bits) {
#if defined(MBEDTLS_ECP_DP_BP256R1_ENABLED)
                case 256: return MBEDTLS_ECP_DP_BP256R1;
#endif
#if defined(MBEDTLS_ECP_DP_BP384R1_ENABLED)
                case 384: return MBEDTLS_ECP_DP_BP384R1;
#endif
#if defined(MBEDTLS_ECP_DP_BP512R1_ENABLED)
                case 512: return MBEDTLS_ECP_DP_BP512R1;
#endif
                default:  return MBEDTLS_ECP_DP_NONE;
            }
        case PSA_ECC_FAMILY_MONTGOMERY:
            switch (bits) {
#if defined(MBEDTLS_ECP_DP_CURVE25519_ENABLED)
                case 255: return MBEDTLS_ECP_DP_CURVE25519;
#endif
#if defined(MBEDTLS_ECP_DP_CURVE448_ENABLED)
                case 448: return MBEDTLS_ECP_DP_CURVE448;
#endif
                default:  return MBEDTLS_ECP_DP_NONE;
            }
        default:
            return MBEDTLS_ECP_DP_NONE;
    }
}

static inline mbedtls_ecp_keypair *mbedtls_pk_ec(mbedtls_pk_context ctx)
{
    static mbedtls_ecp_keypair kp;
    mbedtls_ecp_keypair_free(&kp);
    mbedtls_ecp_keypair_init(&kp);
    mbedtls_ecp_group_id grp_id = mbedtls_pk_ec_psa_to_grp(
            ctx.MBEDTLS_PRIVATE(ec_family), ctx.MBEDTLS_PRIVATE(bits));
    if (grp_id == MBEDTLS_ECP_DP_NONE) return NULL;
    if (mbedtls_ecp_group_load(&kp.MBEDTLS_PRIVATE(grp), grp_id) != 0) return NULL;
    if (mbedtls_ecp_point_read_binary(&kp.MBEDTLS_PRIVATE(grp), &kp.MBEDTLS_PRIVATE(Q),
                ctx.MBEDTLS_PRIVATE(pub_raw), ctx.MBEDTLS_PRIVATE(pub_raw_len)) != 0)
        return NULL;
    return &kp;
}

#ifdef __cplusplus
}
#endif
#endif /* MBEDTLS_PK_SHIM_H */
]=])

set(CHIP_CFLAGS
    "-I${_CHIP_MBEDTLS_COMPAT}"
    "-I${TF_PSA_CRYPTO_BUILTIN_INCLUDE}"
    "-I${TF_PSA_CRYPTO_INCLUDE}"
    # MBEDTLS_ALLOW_PRIVATE_ACCESS → private_access.h defines
    # MBEDTLS_DECLARE_PRIVATE_IDENTIFIERS, enabling all declarations in
    # mbedtls/private/ecp.h and mbedtls/private/pk_private.h.
    "-DMBEDTLS_ALLOW_PRIVATE_ACCESS"
    # Suppress add_entropy_source() in PlatformManagerImpl.cpp — the PSA
    # backend returns CHIP_ERROR_UNSUPPORTED_CHIP_FEATURE for that call.
    "-DCONFIG_MBEDTLS_ENTROPY_POLL_ZEPHYR=1"
    # ── ODR fix: ensure ALL GN targets see the same Server class layout ──
    # Zephyr's autoconf.h (-imacros) is only applied to GN targets that use
    # target_cflags_cc (e.g. Server.cpp).  Codegen cluster targets
    # (zzz_generated/app-common/clusters/*) are compiled WITHOUT autoconf.h.
    # CHIPPlatformConfig.h gates several layout-affecting defines on Kconfig
    # symbols from autoconf.h (CONFIG_CHIP_CRYPTO_PSA → SHA256 context size,
    # CONFIG_CHIP_LOG_SIZE_OPTIMIZATION → log module enables).
    # Without these, the Server class has a different memory layout in codegen
    # TUs → inline GetFabricTable() computes the wrong offset → ODR violation
    # → mOperationalKeystore appears NULL → CSR fails with error 3.
    # Propagate the critical Kconfig symbols via CHIP_CFLAGS so every GN TU
    # sees the same class layout.
    "-DCONFIG_CHIP_CRYPTO_PSA"
)

# ── Pre-set GN_EXECUTABLE ────────────────────────────────────────────────────
# chip-module's CMakeLists.txt calls find_program(GN_EXECUTABLE gn) during
# find_package(Zephyr).  On Windows, gn.exe lives in the Zephyr venv alongside
# west and python.exe.  If gn is not on the system PATH (common in CI and fresh
# shells), pre-populate the cache variable before find_program() runs.
#
# Search order:
#  1. Next to WEST_PYTHON (set by west when invoking cmake)
#  2. Next to Python3_EXECUTABLE if explicitly provided
#  3. Well-known venv locations relative to the workspace root
if(NOT GN_EXECUTABLE)
    # Collect candidate script directories to search
    set(_gn_search_dirs "")

    if(DEFINED WEST_PYTHON)
        get_filename_component(_d "${WEST_PYTHON}" DIRECTORY)
        list(APPEND _gn_search_dirs "${_d}")
    endif()

    if(DEFINED Python3_EXECUTABLE)
        get_filename_component(_d "${Python3_EXECUTABLE}" DIRECTORY)
        list(APPEND _gn_search_dirs "${_d}")
    endif()

    # Fallback: common venv locations relative to workspace root
    # (workspace = parent of repo; also check inside repo itself)
    foreach(_venv
            "${WORKSPACE_DIR}/.zephyr-venv/Scripts"
            "${RT583_PROJECT_DIR}/.zephyr-venv/Scripts"
            "${WORKSPACE_DIR}/.venv/Scripts"
            "${RT583_PROJECT_DIR}/.venv/Scripts"
    )
        list(APPEND _gn_search_dirs "${_venv}")
    endforeach()

    if(WIN32)
        set(_gn_name "gn.exe")
    else()
        set(_gn_name "gn")
    endif()

    foreach(_dir ${_gn_search_dirs})
        set(_candidate "${_dir}/${_gn_name}")
        if(EXISTS "${_candidate}")
            set(GN_EXECUTABLE "${_candidate}" CACHE FILEPATH "Path to gn" FORCE)
            message(STATUS "Pre-set GN_EXECUTABLE: ${GN_EXECUTABLE}")
            break()
        endif()
    endforeach()
endif()

find_package(Zephyr REQUIRED HINTS $ENV{ZEPHYR_BASE})
project(rt583-matter-lighting VERSION 1.0.0)

# ── C++17 (required by Matter) ───────────────────────────────────────────────
include(${CHIP_ROOT}/config/zephyr/app/enable-gnu-std.cmake)

# ── Matter data model (ZAP-generated code + cluster implementations) ─────────
# connectedhomeip codegen scripts (codegen_paths.py, codegen.py) import:
#   'python_path'  — Pigweed helper (not present without full Pigweed bootstrap)
#   'matter.idl.*' — from ${CHIP_ROOT}/scripts/py_matter_idl/
#
# python_path.py is generated into the build directory at configure time so
# the source tree needs no committed shim files.
set(_CHIP_SCRIPTS_COMPAT "${CMAKE_BINARY_DIR}/chip_scripts_compat")
file(WRITE "${_CHIP_SCRIPTS_COMPAT}/python_path.py"
[=["""Minimal shim for Pigweed's python_path module (auto-generated, do not edit).
connectedhomeip codegen scripts import PythonPath from this module when Pigweed
is not fully bootstrapped.  PythonPath(subdir, relative_to=__file__) is a
context manager that prepends <dirname(relative_to)>/<subdir> to sys.path.
"""
import os, sys

class PythonPath:
    def __init__(self, subdir, relative_to=None):
        base = os.path.dirname(os.path.abspath(relative_to)) if relative_to else os.getcwd()
        self._path = os.path.join(base, subdir)
        self._added = False
    def __enter__(self):
        if self._path not in sys.path:
            sys.path.insert(0, self._path)
            self._added = True
        return self
    def __exit__(self, *_):
        if self._added:
            try: sys.path.remove(self._path)
            except ValueError: pass
        return False
]=])

if(WIN32)
    set(ENV{PYTHONPATH} "${CHIP_ROOT}/scripts;${_CHIP_SCRIPTS_COMPAT};$ENV{PYTHONPATH}")
else()
    set(ENV{PYTHONPATH} "${CHIP_ROOT}/scripts:${_CHIP_SCRIPTS_COMPAT}:$ENV{PYTHONPATH}")
endif()

include(${CHIP_ROOT}/src/app/chip_data_model.cmake)

# ── Diagnostic: dump codegen_paths.py state so sysbuild failures are visible ──
# chip_codegen.cmake runs codegen_paths.py via execute_process without capturing
# return code, so a failure there silently yields an empty OUT_NAMES list and
# later blows up at add_custom_command. Repeat the call with RESULT/ERROR vars.
find_package(Python3 QUIET)
message(STATUS "[rt583-diag] Python3_EXECUTABLE = ${Python3_EXECUTABLE}")
message(STATUS "[rt583-diag] VIRTUAL_ENV = $ENV{VIRTUAL_ENV}")
message(STATUS "[rt583-diag] CHIP_ROOT = ${CHIP_ROOT}")
message(STATUS "[rt583-diag] CMAKE_BINARY_DIR = ${CMAKE_BINARY_DIR}")
execute_process(
    COMMAND "${Python3_EXECUTABLE}" -X utf8
        "${CHIP_ROOT}/scripts/codegen_paths.py"
        "--idl" "${CMAKE_CURRENT_LIST_DIR}/lighting-app.matter"
        "app/PluginApplicationCallbacks.h" "app/callback-stub.cpp"
    RESULT_VARIABLE _rt583_cp_rc
    OUTPUT_VARIABLE _rt583_cp_out
    ERROR_VARIABLE  _rt583_cp_err
)
message(STATUS "[rt583-diag] codegen_paths.py rc=${_rt583_cp_rc}")
message(STATUS "[rt583-diag] codegen_paths.py stdout: ${_rt583_cp_out}")
message(STATUS "[rt583-diag] codegen_paths.py stderr: ${_rt583_cp_err}")

chip_configure_data_model(app
    INCLUDE_SERVER
    ZAP_FILE ${CMAKE_CURRENT_LIST_DIR}/lighting-app.zap
    MATTER_IDLS ${CMAKE_CURRENT_LIST_DIR}/lighting-app.matter
)

# ── ODR fix: remove server sources from CMake build ──────────────────────────
# chip_configure_data_model(INCLUDE_SERVER) adds Server.cpp and
# CommissioningWindowManager.cpp to the CMake app target.  These are ALSO
# compiled by the GN build (into libCHIP.a) which uses its own include-path
# order for mbedTLS / TF-PSA-Crypto headers.  PASESession.cpp is compiled
# ONLY by GN.  If CMake and GN resolve psa_pake_operation_t to different
# struct sizes, CommissioningWindowManager (which embeds PASESession) has an
# ODR violation: the GN-compiled PASESession::Clear() writes past the
# CMake-allocated CommissioningWindowManager boundary, corrupting adjacent
# Server members.  Removing these two files from the CMake build forces the
# linker to use the GN-compiled .o files from libCHIP.a, where all TUs see
# the same headers.  --allow-multiple-definition (already set) ensures the
# remaining duplicates (from other server sources) link without error.
get_target_property(_app_srcs app SOURCES)
list(REMOVE_ITEM _app_srcs
    "${CHIP_ROOT}/src/app/server/Server.cpp"
    "${CHIP_ROOT}/src/app/server/CommissioningWindowManager.cpp"
)
set_property(TARGET app PROPERTY SOURCES ${_app_srcs})

# ── ODR fix: align CMake CHIP_CONFIG_* with GN build ─────────────────────────
# chip_configure_data_model() adds CodegenIntegration.cpp files to the CMake
# app target.  These call inline Server accessors (GetFabricTable, etc.) whose
# compiled offset depends on CHIP_CONFIG_* macros from GN-generated headers in
# gen/include (AppBuildConfig.h, ICDServerBuildConfig.h, CHIPDeviceBuildConfig.h).
#
# Problem 1 — wrong CHIP_HAVE_CONFIG_H value:
#   Zephyr sets -DCHIP_HAVE_CONFIG_H (no value → expands to empty → #if evaluates
#   to 0), so AppBuildConfig.h is NOT included and all CHIP_CONFIG_* macros use
#   their defaults.  GN sets -DCHIP_HAVE_CONFIG_H=1 → AppBuildConfig.h IS
#   included.  This causes Server member sizes (SessionManager, ExchangeManager)
#   to differ by 312 bytes between the two build systems.
#
# Problem 2 — missing gen/include search path:
#   The CMake build doesn't add gen/include to its -I list, so even if
#   CHIP_HAVE_CONFIG_H=1 were set, #include <app/AppBuildConfig.h> would fail.
#
# Fix: prepend gen/include to the include search path and redefine
# CHIP_HAVE_CONFIG_H=1 (using -U to clear the valueless definition first).
# This makes all CodegenIntegration.cpp TUs see the same struct layouts as the
# GN-compiled Server.cpp, eliminating the ODR violation on inline accessors.
target_include_directories(app BEFORE PRIVATE
    "${CMAKE_BINARY_DIR}/modules/connectedhomeip/gen/include"
)
target_compile_options(app PRIVATE
    -UCHIP_HAVE_CONFIG_H
    -DCHIP_HAVE_CONFIG_H=1
)

# ── Include directories ──────────────────────────────────────────────────────
# SoC platform/HOSAL/crypto include dirs and hosal_gpio.c are added by the
# module-level CMakeLists (cmake/zephyr_module/CMakeLists.txt) — example only
# adds Matter-specific paths here.
target_include_directories(app PRIVATE
    src/include
    ${GEN_DIR}
    ${GEN_DIR}/app-common
    ${GEN_DIR}/lighting-app
    ${CHIP_ROOT}/examples/lighting-app/lighting-common
    ${CHIP_ROOT}/examples/providers
)

# ── Application sources ──────────────────────────────────────────────────────
target_sources(app PRIVATE
    src/main.cpp
    src/AppTask.cpp
    src/CryptoSelfTest.cpp
    src/ZclCallbacks.cpp
    src/MallocWrappers.cpp
    src/ecp_enum_compat.c
    ${CHIP_ROOT}/examples/providers/DeviceInfoProviderImpl.cpp
)

# Redirect ALL heap allocations to our sys_heap wrapper (MallocWrappers.cpp).
# --wrap=malloc/calloc/realloc/free covers CHIP SDK and C++ operator new/delete.
# --wrap=_malloc_r/... covers newlib reentrant calls (strdup, printf internals,
# etc.) that bypass the public malloc symbol and call _malloc_r directly.
# Without the _malloc_r wraps, strdup() during Server::Init exhausts the 2 KB
# k_heap (shared with BT GATT) → NULL → CHIP_ERROR_NO_MEMORY.
zephyr_ld_options(
    -Wl,--wrap=malloc
    -Wl,--wrap=calloc
    -Wl,--wrap=realloc
    -Wl,--wrap=free
    -Wl,--wrap=_malloc_r
    -Wl,--wrap=_free_r
    -Wl,--wrap=_calloc_r
    -Wl,--wrap=_realloc_r
)

# ECP enum compatibility: CHIP (TF-PSA-Crypto) passes SECP256R1=1 but OT's linked
# mbedtls_ecp_group_load (mbedTLS 3.6.0) expects SECP256R1=3 → FEATURE_UNAVAILABLE.
# --wrap redirects all callers through __wrap_mbedtls_ecp_group_load which translates
# 1→3 before forwarding to OT's __real implementation.
zephyr_ld_options(-Wl,--wrap=mbedtls_ecp_group_load)
# psa_key_derivation_setup safety-net: restores operation->alg and capacity when
# a linker resolution bug zeroes them.  Root cause also fixed in psa_crypto.c.
zephyr_ld_options(-Wl,--wrap=psa_key_derivation_setup)

# ── BLE + OpenThread subsystems ──────────────────────────────────────────────
if(CONFIG_BLE_RT583 OR CONFIG_BLE_RT584)
    set(RAFAEL_SDK ${RT583_PROJECT_DIR}/sdk)
    include(${RT583_PROJECT_DIR}/subsys/ble/CMakeLists.txt)
endif()

if(CONFIG_OPENTHREAD_RT583 OR CONFIG_OPENTHREAD_RT584)
    # subsys/openthread/CMakeLists.txt expects RAFAEL_SDK; set it here in case
    # the BLE branch above didn't run (rt584 currently builds without BLE).
    if(NOT DEFINED RAFAEL_SDK)
        set(RAFAEL_SDK ${RT583_PROJECT_DIR}/sdk)
    endif()
    # Matter doesn't need the OT CLI — disable it to save ~37 KB flash / 7 KB BSS.
    set(OT_INCLUDE_CLI 0)
    include(${RT583_PROJECT_DIR}/subsys/openthread/CMakeLists.txt)
endif()

# comm_subsystem_drv.c — added by module-level CMake when OT/BLE is on.

# Dummy net interface — provides an IPv6 link-local address so that Matter's
# Server::Init can bind UDP sockets.  RT583's OT radio uses vendored lmac15p4
# (not a Zephyr ieee802154 driver), so no real net_if is registered.
target_sources(app PRIVATE ${RT583_PROJECT_DIR}/drivers/net/dummy_net_if.c)

# RF firmware selection for multi-protocol (BLE + 802.15.4) coexistence.
# rf_common_init_by_fw() checks CONFIG_RF_FW_INCLUDE_* at compile time.
# MULTI_2P4G loads a combined firmware that supports both BLE and Thread
# simultaneously — required for a Matter over Thread device.
# PCI (RUCI/MAC path) and BLE are included so the OT and BLE CMakeLists
# sub-includes below do not override with conflicting FALSE settings.
target_compile_definitions(app PRIVATE
    # MULTI_2P4G: combined BLE+802.15.4 firmware — required for Matter over Thread.
    CONFIG_RF_FW_INCLUDE_MULTI_2P4G=TRUE
    CONFIG_RF_MCU_CONST_LOAD_SUPPORTED=TRUE
    CONFIG_CRYPTO_AES_ENABLE=1
)

# ── ODR fix: Server class layout must match across Zephyr-side and GN-side ─────
# CONFIG_CHIP_USE_OT_ENDPOINT=y in prj.conf is consumed by
# connectedhomeip/config/common/cmake/chip_gn_kconfig_defaults.cmake only when
# that helper runs under the chip-module Kconfig path — it translates the
# Kconfig symbol into a GN arg that surfaces as
# CHIP_SYSTEM_CONFIG_USE_OPENTHREAD_ENDPOINT=1 inside GN's SystemBuildConfig.h.
#
# Every GN-side TU (Server.cpp, FabricTable.cpp, SessionManager.cpp, …) sees
# the flag that way, but Zephyr-side TUs like AppTask.cpp do NOT pull in
# SystemBuildConfig.h.  Without the define, Server.h / SessionManager.h compile
# with different sizeof(UDPEndPoint) + sizeof(TransportMgr) and Server::mFabrics
# lands at a different offset for each side — making Server::GetInstance()
# .GetFabricTable() return a pointer that is 312 bytes off from the instance
# that Server::Init() populated.  Symptom: FabricTable::mOperationalKeystore
# reads NULL and CSRRequest fails with CHIP_ERROR_INCORRECT_STATE (0x03).
#
# Propagate the flag to every Zephyr-side TU (app + related modules) so both
# sides agree on the Server layout.
zephyr_compile_definitions(CHIP_SYSTEM_CONFIG_USE_OPENTHREAD_ENDPOINT=1)

# Suppress warnings in vendored SDK sources
target_compile_options(app PRIVATE -Wno-error=maybe-uninitialized)

# OT's bundled mbedTLS 3.6 vs Zephyr's TF-PSA-Crypto 4.0: cipher_context_t
# struct layout differs.  OT code is compiled against 3.6 headers, so the
# compiled .c bodies (cipher.c / constant_time.c / psa_util.c) MUST come from
# OT's 3.6 set — otherwise mbedtls_cipher_free dereferences the wrong struct
# offset for ctx_free_func and jumps to a garbage function pointer.
# -Wl,--allow-multiple-definition + libapp.a ordered before libtfpsacrypto.a
# makes OT's 3.6 versions win the link.
zephyr_ld_options(-Wl,--allow-multiple-definition)
```

## prj.conf
```kconfig
# Matter Lighting App — board-neutral common config.
# Board-specific Kconfigs live in boards/<board>.conf:
#   boards/rt583_evb.conf — BLE driver + ieee802154 + BT device name
#   boards/rt584_evb.conf — BLE disabled (Phase B BLE driver TODO)
#
# Implements a Matter over Thread lighting device. BLE commissioning
# requires the rt58x BLE driver — currently only rt583_evb is fully
# wired (Phase A on rt584).
#
# Prerequisites:
#   - connectedhomeip cloned at <workspace>/connectedhomeip (or CHIP_ROOT env var)
#   - GN build system installed and on PATH
#   - west update (to fetch all modules)

# ── Hardware (UART/FLASH driver auto-default per SoC series) ──────────────────
CONFIG_SERIAL=y
CONFIG_CONSOLE=y
CONFIG_UART_CONSOLE=y
CONFIG_UART_INTERRUPT_DRIVEN=y
CONFIG_PRINTK=y

CONFIG_FLASH=y
CONFIG_FLASH_PAGE_LAYOUT=y
CONFIG_FLASH_MAP=y

# ── Memory ────────────────────────────────────────────────────────────────────
# Build links picolibc (selected via root prj.conf).  Need picolibc's STANDARD
# IO formatter; the default MINIMAL variant drops width padding for %08X,
# which breaks Matter's operational mDNS instance name
# ("<fabric>-<nodeid>", 16 hex digits each).  Without this, SRP registers
# e.g. "<fabric>-42" and chip-tool's Avahi lookup for the correctly-formatted
# "<fabric>-0000000000000042" never matches.
CONFIG_PICOLIBC_IO_LONG_LONG=y
# Zephyr system heap (k_malloc): used only for BT GATT dynamic DB, thread names,
# and other Zephyr-internal k_malloc callers.  CHIP uses its own dedicated heap
# (CONFIG_CHIP_MALLOC_SYS_HEAP below) so this can be small.
CONFIG_HEAP_MEM_POOL_SIZE=2048
# main only creates app_thread then returns — minimal stack needed.
CONFIG_MAIN_STACK_SIZE=1024
# System workqueue: 252 bytes peak measured; 1 KB is safe margin.
CONFIG_SYSTEM_WORKQUEUE_STACK_SIZE=1024
# ISR stack: 180 bytes peak; 1024 bytes for BLE/OT nested IRQ headroom.
CONFIG_ISR_STACK_SIZE=1024
# Matter chip task stack — needs headroom for Server::Init call chain (via ScheduleWork).
CONFIG_CHIP_TASK_STACK_SIZE=14336
# Zephyr OT work queue thread stack (modules/openthread/openthread.c).
# Drives otTaskletsProcess() and otSysProcessDrivers() for the OT state machine.
# 3072 B is sufficient for FTD task processing; default is 6144 (too large for RT583).
CONFIG_OPENTHREAD_THREAD_STACK_SIZE=3072
# Event queue: 20 events is sufficient for a lighting device
CONFIG_MAX_EVENT_QUEUE_SIZE=20

# ── Matter (CHIP) ─────────────────────────────────────────────────────────────
CONFIG_CHIP=y
CONFIG_STD_CPP17=y
CONFIG_CHIP_PROJECT_CONFIG="src/include/CHIPProjectConfig.h"

# PSA crypto backend (CHIPCryptoPALPSA.cpp) with mbedTLS SPAKE2+ ECP backend.
# chip_crypto = "psa": Hash, HMAC, KDF via TF-PSA-Crypto PSA APIs.
# chip_crypto_spake2p = "mbedtls": ECP point arithmetic via mbedTLS API.
#
# At link time, OT bundles its own mbedTLS 3.6.0 (libapp.a).  With
# --allow-multiple-definition, OT's mbedtls_ecp_* / mbedtls_sha256_* /
# mbedtls_md_* symbols win over TF-PSA-Crypto 4.0 duplicates.
# PSA KDF (psa_key_derivation_*) and PSA hash (psa_hash_*) are NOT in OT's
# mbedTLS — they resolve to TF-PSA-Crypto exclusively.
#
# --wrap=mbedtls_ecp_group_load in ecp_enum_compat.c translates SECP256R1
# from TF-PSA-Crypto's value (1) to OT mbedTLS 3.6.0's value (3) so that
# all ECP operations target the correct curve.
#
# NOTE: CONFIG_CHIP_CRYPTO_MBEDTLS=y (CHIPCryptoPALmbedTLS.cpp) is NOT used
# because CHIPCryptoPALmbedTLS.cpp calls mbedtls_hkdf() which was removed in
# TF-PSA-Crypto 4.0 and is not present in OT's mbedTLS 3.6.0 (no MBEDTLS_HKDF_C).
CONFIG_CHIP_CRYPTO_PSA=y
CONFIG_CHIP_CRYPTO_SPAKE2P_MBEDTLS=y


# Product/vendor IDs — use test values (must be decimal for int-type Kconfig)
CONFIG_CHIP_DEVICE_VENDOR_ID=65521
CONFIG_CHIP_DEVICE_PRODUCT_ID=32773

# Start BLE advertisement automatically after boot (for commissioning)
CONFIG_CHIP_ENABLE_PAIRING_AUTOSTART=y

# Disable features not yet supported on RT583
CONFIG_CHIP_FACTORY_DATA=n
CONFIG_CHIP_FACTORY_DATA_BUILD=n
CONFIG_CHIP_NFC_ONBOARDING_PAYLOAD=n
CONFIG_CHIP_OTA_REQUESTOR=n
CONFIG_CHIP_LIB_SHELL=n
# Zephyr v4.4+ already provides recvmsg() in net/socket.h; disable Matter's
# older stub (ZEPHYR_SOCKET_EXTENSIONS) to avoid 'extern' vs 'static' conflict.
CONFIG_CHIP_SYSTEM_USE_ZEPHYR_SOCKET_EXTENSIONS=n
# RT583 OT radio uses vendored lmac15p4 (not a Zephyr ieee802154 driver), so
# Zephyr's NET_L2 openthread layer has no net_if registered.  Without a net_if,
# POSIX socket bind() returns EADDRNOTAVAIL and Advertiser_ImplMinimalMdns::Init()
# fails (mIsInitialized stays false), causing every Advertise() call to return
# CHIP_ERROR_INCORRECT_STATE (3) — "Failed to advertise commissionable node: 3".
# Fix: use OT's native UDP endpoints (otUdpBind/Send) instead of POSIX sockets.
# AppTask::ServerInitWork sets endpointNativeParams with the OT instance and
# lock callbacks so UDPEndPointImplOT binds via OT directly.
CONFIG_CHIP_USE_OT_ENDPOINT=y

# ── BLE (commissioning transport) — board-specific defaults ──────────────────
# rt583_evb: full BLE chain (boards/rt583_evb.conf).
# rt584_evb: BLE disabled (boards/rt584_evb.conf) — Phase B BLE driver TODO.
# Common BT config (only takes effect when board enables CONFIG_BT=y):
CONFIG_BT_PERIPHERAL=y
# Dynamic GATT service registration — required by Matter's BLEManagerImpl
CONFIG_BT_GATT_DYNAMIC_DB=y

CONFIG_BT_L2CAP_TX_MTU=247
CONFIG_BT_BUF_ACL_RX_SIZE=251
# HCI event RX pool: default 3 exhausts during PASE exchange (frequent 0x13
# Num Completed Packets events) → ACL TX credits lost → GATT indication
# failures → PASE fails with CHIP_ERROR_INTERNAL. 8 is sufficient.
CONFIG_BT_BUF_EVT_RX_COUNT=8

# ── OpenThread (operational transport) ───────────────────────────────────────
CONFIG_NET_L2_OPENTHREAD=y
CONFIG_NETWORKING=y
CONFIG_NET_PKT_TXTIME=y
# Dummy L2 for the dummy_net_if driver (provides net_if for socket bind)
CONFIG_NET_L2_DUMMY=y
CONFIG_NET_PKT_TIMESTAMP=y
CONFIG_NET_IF_MCAST_IPV6_ADDR_COUNT=14

# OPENTHREAD_RT583 / OPENTHREAD_RT584 auto-default per SoC via Kconfig
# choice OPENTHREAD_IMPLEMENTATION (top-level Kconfig).
# IEEE802154_RAFAEL_FULL is rt583-only (no rt584 counterpart) — moved
# to boards/rt583_evb.conf.
CONFIG_OPENTHREAD_FTD=y
CONFIG_OPENTHREAD_MANUAL_START=y
CONFIG_OPENTHREAD_THREAD_VERSION_1_3=y
CONFIG_OPENTHREAD_COAP=n
CONFIG_OPENTHREAD_COMMISSIONER=n
CONFIG_OPENTHREAD_DNS_CLIENT=y
CONFIG_OPENTHREAD_JOINER=n
CONFIG_OPENTHREAD_SRP_CLIENT=y
# SRP server: when the RT583 is a standalone Thread Leader (no Border Router),
# enable the built-in SRP server so the local SRP client can register Matter
# services.  AppTask enables it via otSrpServerSetEnabled() on role→Leader and
# disables it when a Border Router takes over (role→Router/Child).
CONFIG_OPENTHREAD_SRP_SERVER=y
CONFIG_OPENTHREAD_ECDSA=y
CONFIG_OPENTHREAD_EXTERNAL_HEAP=y
# Matter needs its own state change callback in addition to Zephyr's L2 handler.
CONFIG_OPENTHREAD_MAX_STATECHANGE_HANDLERS=3

# ── Settings (persistent storage for Matter fabric/credential data) ───────────
# NVS over FCB: each missing-key lookup on FCB walks the whole 64 KB storage
# partition (~1.27 s per attribute read on fresh flash).  NVS keeps an in-RAM
# index so lookups are O(1) — Server::Init drops from ~30+ s to <1 s.
CONFIG_SETTINGS=y
CONFIG_SETTINGS_NVS=y
CONFIG_NVS=y

# ── Random number generator ───────────────────────────────────────────────────
# ENTROPY_GENERATOR enables the entropy subsystem; ENTROPY_RT583 activates the
# RT583 hardware TRNG driver (auto-selected via Kconfig 'default y' when
# DT_HAS_RAFAEL_RT583_TRNG_ENABLED && ENTROPY_GENERATOR).
CONFIG_ENTROPY_GENERATOR=y
# Use the RT583 TRNG hardware directly as the CSPRNG — no PSA loop.
# HARDWARE_DEVICE_CS_GENERATOR is the Zephyr default when ENTROPY_HAS_DRIVER=y;
# we state it explicitly because the chip-module might otherwise force
# PSA_CSPRNG_GENERATOR=y, which creates an infinite recursion with
# MBEDTLS_PSA_CRYPTO_EXTERNAL_RNG=y:
#   sys_csrand_get → psa_generate_random → mbedtls_psa_external_get_random
#   → sys_csrand_get → ...
# With HARDWARE_DEVICE_CS_GENERATOR, sys_csrand_get → TRNG hardware (no PSA).
# PSA external RNG then resolves safely: psa_generate_random
#   → mbedtls_psa_external_get_random → sys_csrand_get → TRNG → bytes.
CONFIG_HARDWARE_DEVICE_CS_GENERATOR=y

# CHIP malloc heap: disable the GN-side SysHeapMalloc.cpp so CHIP uses plain
# CHIPMem-Malloc.cpp (calls malloc/free).  MallocWrappers.cpp provides a
# self-contained sys_heap backed by s_heap_buf[12288] with canary/magic
# overflow detection.  12 KB is sufficient for Server::Init (~8-10 KB peak);
# CONFIG_CHIP_MALLOC_SYS_HEAP_SIZE is informational only (CHIP_MALLOC_SYS_HEAP=n)
# — the actual size is APP_MALLOC_HEAP_SIZE in MallocWrappers.cpp.
CONFIG_CHIP_MALLOC_SYS_HEAP=n
CONFIG_CHIP_MALLOC_SYS_HEAP_SIZE=12288
# Heap structural validation disabled to save flash (removes validate path from sys_heap).
CONFIG_SYS_HEAP_VALIDATE=n

# mbedTLS heap: used by ECP operations (MPI limb allocation during SPAKE2+
# and the ECDH bypass's mbedtls_ecp_mul), X.509 cert parsing, and PSA
# derivation.  During CASE we saw PSA -141 (INSUFFICIENT_MEMORY) at
# DeriveKey with 8 KB.  12 KB fits the RAM budget (RT583 has 144 KB total).
CONFIG_MBEDTLS_HEAP_SIZE=10240

# PSA volatile key slots — CASE allocates multiple derived keys (HKDF
# output keys for Sigma2/3 transcript + session).  Default may be only 8.
CONFIG_MBEDTLS_PSA_KEY_SLOT_COUNT=32

# ── MCUboot ───────────────────────────────────────────────────────────────────
# Signed MCUboot image.  sysbuild builds + flashes MCUboot itself via
# sysbuild.conf (SB_CONFIG_BOOTLOADER_MCUBOOT=y).  SWAP_WITHOUT_SCRATCH mode
# (set at the sysbuild level) avoids the Direct-XIP slot1_variant build that
# pushes connectedhomeip's deeply-nested Cluster.cpp.o paths past Windows'
# 260-char MAX_PATH — the GCC toolchain's `ar` has no long-path manifest, so
# LongPathsEnabled=1 isn't enough to rescue Direct-XIP.
CONFIG_BOOTLOADER_MCUBOOT=y
CONFIG_MCUBOOT_GENERATE_UNSIGNED_IMAGE=y
CONFIG_MCUBOOT_IMGTOOL_SIGN_VERSION="1.0.0"

# Generate Intel HEX output — west flash (openocd runner) uses the hex file
# which embeds the load address (slot0 = 0x10000), so no --flash-address needed.
CONFIG_BUILD_OUTPUT_HEX=y

# ── Factory reset ─────────────────────────────────────────────────────────────
# Full NVS wipe on factory reset (not just CHIP keys).  Without this, settings
# like thread credentials persist across "factory reset".
CONFIG_CHIP_FACTORY_RESET_ERASE_SETTINGS=y

# ── Misc ──────────────────────────────────────────────────────────────────────
CONFIG_THREAD_NAME=n
CONFIG_SHELL=n
CONFIG_FAULT_DUMP=0

# ── Debug ─────────────────────────────────────────────────────────────────────
# Enable Zephyr LOG so ChipLogProgress/ChipLogError (Matter SDK) output.
# LOG_MODE_MINIMAL: lightweight synchronous output (no buffer, no thread).
# MATTER_LOG_LEVEL=3: Info/Progress -- shows [DL],[SVR],[IN],[DIS] etc.
CONFIG_LOG=y
CONFIG_LOG_MODE_MINIMAL=y
CONFIG_MATTER_LOG_LEVEL=3

# Silence non-Matter Zephyr subsystem logs.
# chip-module sets LOG_DEFAULT_LEVEL=3 (INFO) which makes BT, flash, and other
# Zephyr subsystems noisy.  Silence them individually; Matter uses its own
# logging path (ChipLog* -> chip module) unaffected by these settings.
CONFIG_LOG_DEFAULT_LEVEL=1
CONFIG_BT_LOG_LEVEL_OFF=y
# Disable BT assert so HCI timeout after RF mode switch (MULTI_PROTOCOL →
# RUCI_CMD) doesn't crash the system.  BLE is dead after the switch — expected.
CONFIG_BT_ASSERT=n
CONFIG_FLASH_LOG_LEVEL_OFF=y
CONFIG_SECURE_STORAGE_LOG_LEVEL_OFF=y

# ── Code size optimizations ───────────────────────────────────────────────────
# -Os (size-optimized) — saves ~30-50 KB flash vs. -O2 on Cortex-M3.
CONFIG_SIZE_OPTIMIZATIONS=y
# Use minimal libc printf (no float/64-bit) — saves ~8 KB flash.
CONFIG_CBPRINTF_NANO=y
# Disable unused Zephyr features to save flash.
CONFIG_SCHED_MULTIQ=n
# LTO must be off: Zephyr adds $<TARGET_PROPERTY:LTO> to compile options when
# CONFIG_LTO=y, and connectedhomeip's chip-module puts those options into
# MATTER_GN_ARGS which is written by file(GENERATE).  CMake 4.x rejects
# $<TARGET_PROPERTY:prop> in file(GENERATE) outside a binary target context.
CONFIG_LTO=n
# CONFIG_ISR_TABLES_LOCAL_DECLARATION is only needed alongside LTO.
CONFIG_ISR_TABLES_LOCAL_DECLARATION=n
CONFIG_STACK_SENTINEL=n

# ── Production / boot-time options ───────────────────────────────────────────
# Disable crypto self-test for faster boot (saves ~50 ms + ~2 KB flash).
# Enable during development with CONFIG_RT583_CRYPTO_SELFTEST=y.
CONFIG_RT583_CRYPTO_SELFTEST=n
# Heap trace compiled out for production (enable for debugging memory issues).
CONFIG_RT583_HEAP_TRACE=n
```

## boards/rt583_evb.conf
```kconfig
# RT583-specific overlay for Matter lighting-app — auto-loaded by Zephyr
# when BOARD=rt583_evb. CONFIG_BLE_RT583 auto-selects via Kconfig
# (default y if SOC_RT583 && BT); only true per-board differences live here.

# BLE device name (rt583_evb branding).
CONFIG_BT_DEVICE_NAME="RT583Light"

# Use the Zephyr ieee802154 driver scaffold so NET_L2_OPENTHREAD has a
# net_if registered (radio still drives lmac15p4 underneath via the
# vendored OT port). The same flag works on rt584_evb — see Kconfig
# IEEE802154_RAFAEL_FULL.
CONFIG_IEEE802154_RAFAEL_FULL=y
```

## boards/rt584_evb.conf
```kconfig
# RT584-specific overlay for Matter lighting-app — auto-loaded by Zephyr
# when BOARD=rt584_evb.

# Path B: Zephyr's modules/openthread/platform/radio.c drives the
# ieee802154_rafael driver via the standard ieee802154_radio_api (same
# flag as examples/thread). The driver is SoC-agnostic and the rt584
# DT compat is wired in drivers/ieee802154/ieee802154_rafael.c.
CONFIG_IEEE802154_RAFAEL_FULL=y

# BLE Phase B in progress. M1 (Thread + Matter chip stack) confirmed
# working with CONFIG_BT=n. Now bringing BLE up: DT bt-hci node added,
# HCI driver compat extended to rafael,rt584-bt-hci. CONFIG_BLE_RT584
# auto-selects via Kconfig default once BT is on.
CONFIG_BT=y
CONFIG_BT_PERIPHERAL=y
CONFIG_BT_DEVICE_NAME="RT584Light"
CONFIG_CHIP_ENABLE_PAIRING_AUTOSTART=y

# rt584 partition layout already matches Matter's needs (slot0/slot1 each
# 928 KB) per dts/arm/rafael/rt584.dtsi — no app.overlay needed.

# Diagnostic Kconfigs (RT583_*) — currently rt583-only in our Kconfig
# tree. Disable explicitly so rt584 build doesn't pick up Kconfig defaults
# that reference rt583 internals.
CONFIG_RT583_CRYPTO_SELFTEST=n
CONFIG_RT583_HEAP_TRACE=n
```

## boards/rt583_evb.overlay
```dts
/*
 * Flash partition override for Matter lighting app.
 *
 * Default slot0/slot1 = 800 KB but matter_lighting image is ~866 KB.
 * MCUboot uses min(slot0, slot1) as the signing size (both slots must
 * be able to hold the same image for Direct XIP failover).
 *
 * Layout (2 MB flash):
 *   0x000000 –  0x010000  boot_partition    64 KB  MCUboot
 *   0x010000 –  0x0F8000  slot0_partition  928 KB  matter_lighting (primary)
 *   0x0F8000 –  0x1E0000  slot1_partition  928 KB  OTA spare / Direct XIP failover
 *   0x1E0000 –  0x1F0000  storage_partition 64 KB  Matter settings / NVS
 *   0x1F0000 –  0x200000  factory_partition 64 KB  factory data
 *   Total: 64 + 928 + 928 + 64 + 64 = 2048 KB = 2 MB
 *
 * Headroom: 928 KB slot − 866 KB image = 62 KB
 */

/*
 * Use PATH-based /delete-node/ here (not label-based with `&...`):
 * Under sysbuild Direct-XIP the slot1_variant build re-applies this overlay
 * on top of the slot0 build's already-processed DT, where staging_partition
 * has been deleted on the first pass.  A label-based `&staging_partition`
 * reference errors ("undefined node label") on the second pass; a path-based
 * `/delete-node/ partition@...;` is idempotent.
 */
&slot0_partition {
    reg = <0x00010000 0x000E8000>;  /* 928 KB */
};

&flash0 {
    partitions {
        /delete-node/ partition@d8000;    /* original slot1 (800 KB) */
        /delete-node/ partition@1a0000;   /* staging — overlaps new slot1 */

        slot1_partition: partition@f8000 {
            label = "image-1";
            reg = <0x000f8000 0x000e8000>;  /* 928 KB — equal to slot0, required by MCUboot */
        };
    };
};
```

## src/CryptoSelfTest.cpp
```c
/*
 * RT583 Hardware Crypto Self-Test
 *
 * Verifies AES-128-ECB, AES-128-CBC, and SHA-256 hardware accelerators
 * against NIST Known-Answer Test (KAT) vectors.
 *
 * Call before hosal_rf_init() so the shared crypto accelerator is idle
 * (lmac15p4 has not started and no concurrent ECC/AES operations can occur).
 *
 * AES and ECC share the same hardware accelerator on RT583.  After this
 * test the accelerator has AES firmware loaded; lmac15p4 will reload
 * whichever firmware it needs when it starts.
 *
 * SHA-256 is implemented in RT583 ROM (function pointers at fixed ROM
 * addresses).  sha256_vector_init() wires those pointers; subsequent
 * calls to sha256_init/update/finish invoke the ROM code directly.
 *
 * Controlled by CONFIG_RT583_CRYPTO_SELFTEST (Kconfig).  When disabled,
 * only sha256_vector_init() is called (required before any HMAC use).
 */

#include <string.h>
#include <zephyr/kernel.h>

extern "C" {
#include "rt_aes.h"
#include "rt_sha256.h"
}

#ifdef CONFIG_RT583_CRYPTO_SELFTEST

/* ── AES-128-ECB — NIST FIPS-197 Appendix B ───────────────────────────────── */
static const uint8_t kAesKey128[16] = {
    0x2b, 0x7e, 0x15, 0x16, 0x28, 0xae, 0xd2, 0xa6,
    0xab, 0xf7, 0x15, 0x88, 0x09, 0xcf, 0x4f, 0x3c,
};
static const uint8_t kAesPlain[16] = {
    0x6b, 0xc1, 0xbe, 0xe2, 0x2e, 0x40, 0x9f, 0x96,
    0xe9, 0x3d, 0x7e, 0x11, 0x73, 0x93, 0x17, 0x2a,
};
static const uint8_t kAesEcbCipher[16] = {
    0x3a, 0xd7, 0x7b, 0xb4, 0x0d, 0x7a, 0x36, 0x60,
    0xa8, 0x9e, 0xca, 0xf3, 0x24, 0x66, 0xef, 0x97,
};

/* ── AES-128-CBC — NIST SP 800-38A Example F.2.1 (first block) ────────────── */
static const uint8_t kAesCbcIv[16] = {
    0x00, 0x01, 0x02, 0x03, 0x04, 0x05, 0x06, 0x07,
    0x08, 0x09, 0x0a, 0x0b, 0x0c, 0x0d, 0x0e, 0x0f,
};
static const uint8_t kAesCbcCipher[16] = {
    0x76, 0x49, 0xab, 0xac, 0x81, 0x19, 0xb2, 0x46,
    0xce, 0xe9, 0x8e, 0x9b, 0x12, 0xe9, 0x19, 0x7d,
};

/*
 * RT583 ROM SHA-256 limitation (raw sha256_init/update/finish):
 *
 * sha256_finish compresses starting from the initial SHA-256 H-constant
 * state when sha256_update has not yet run its internal compression (i.e.
 * total message < 64 bytes in one update call).  In that specific case the
 * ROM produces wrong output — SHA-256("abc") returns the wrong digest.
 *
 * For inputs >= 64 bytes, sha256_update compresses the first full block and
 * leaves a non-initial intermediate state; sha256_finish then produces the
 * correct result.
 *
 * Matter only uses SHA-256 through HMAC-SHA256 / HKDF / PBKDF2.  All of
 * these always hash a >= 64-byte ipad or opad key block through sha256_update
 * first, so they never hit the ROM bug.  The HMAC-SHA256 KAT below (RFC 4231
 * TC1) is the meaningful validator for Matter's code path.
 *
 * We skip the standalone raw-SHA-256 KAT to avoid a misleading failure and
 * just call sha256_vector_init() to wire the ROM function pointers (required
 * before any HMAC call).
 */

/* ── HMAC-SHA256 — RFC 4231 Test Case 1 ───────────────────────────────────── */
static const uint8_t kHmacKey[20] = {
    0x0b, 0x0b, 0x0b, 0x0b, 0x0b, 0x0b, 0x0b, 0x0b,
    0x0b, 0x0b, 0x0b, 0x0b, 0x0b, 0x0b, 0x0b, 0x0b,
    0x0b, 0x0b, 0x0b, 0x0b,
};
static const uint8_t kHmacData[] = { 'H', 'i', ' ', 'T', 'h', 'e', 'r', 'e' };
static const uint8_t kHmacExpected[SHA256_DIGEST_SIZE] = {
    0xb0, 0x34, 0x4c, 0x61, 0xd8, 0xdb, 0x38, 0x53,
    0x5c, 0xa8, 0xaf, 0xce, 0xaf, 0x0b, 0xf1, 0x2b,
    0x88, 0x1d, 0xc2, 0x00, 0xc9, 0x83, 0x3d, 0xa7,
    0x26, 0xe9, 0x37, 0x6c, 0x2e, 0x32, 0xcf, 0xf7,
};

/* ── Helpers ──────────────────────────────────────────────────────────────── */

static void print_hex(const char *label, const uint8_t *buf, size_t len)
{
    printk("  %s: ", label);
    for (size_t i = 0; i < len; i++) {
        printk("%02x", buf[i]);
    }
    printk("\n");
}

/* ── AES-128-ECB test ─────────────────────────────────────────────────────── */

static bool test_aes128_ecb(void)
{
    struct aes_ctx ctx;
    uint8_t cipher[16];
    uint8_t recovered[16];
    bool ok = true;

    /* Load AES firmware to the shared crypto accelerator */
    aes_fw_init();
    aes_key_init(&ctx, kAesKey128, AES_KEY128);
    aes_load_round_key(&ctx);

    uint32_t t0 = k_uptime_get_32();
    aes_ecb_encrypt(&ctx, (uint8_t *)kAesPlain, cipher);
    uint32_t enc_ms = k_uptime_get_32() - t0;

    if (memcmp(cipher, kAesEcbCipher, 16) != 0) {
        print_hex("got ", cipher, 16);
        print_hex("want", kAesEcbCipher, 16);
        ok = false;
    }

    aes_ecb_decrypt(&ctx, cipher, recovered);
    if (memcmp(recovered, kAesPlain, 16) != 0) {
        ok = false;
    }

    if (ok) {
    }
    return ok;
}

/* ── AES-128-CBC test ─────────────────────────────────────────────────────── */

static bool test_aes128_cbc(void)
{
    struct aes_ctx ctx;
    uint8_t cipher[16];
    uint8_t recovered[16];
    bool ok = true;

    /* aes_fw_init() already called in ECB test; key still loaded */
    aes_key_init(&ctx, kAesKey128, AES_KEY128);
    aes_load_round_key(&ctx);
    aes_iv_set(&ctx, kAesCbcIv);

    uint32_t t0 = k_uptime_get_32();
    aes_cbc_buffer_encrypt(&ctx, (uint8_t *)kAesPlain, cipher, 16);
    uint32_t enc_ms = k_uptime_get_32() - t0;

    if (memcmp(cipher, kAesCbcCipher, 16) != 0) {
        print_hex("got ", cipher, 16);
        print_hex("want", kAesCbcCipher, 16);
        ok = false;
    }

    /* Decrypt: reset key and IV */
    aes_key_init(&ctx, kAesKey128, AES_KEY128);
    aes_load_round_key(&ctx);
    aes_iv_set(&ctx, kAesCbcIv);
    aes_cbc_buffer_decrypt(&ctx, cipher, recovered, 16);

    if (memcmp(recovered, kAesPlain, 16) != 0) {
        ok = false;
    }

    if (ok) {
    }
    return ok;
}

/* ── SHA-256 init ─────────────────────────────────────────────────────────── */

static bool test_sha256(void)
{
    sha256_vector_init();
    return true;
}

/* ── HMAC-SHA256 test ─────────────────────────────────────────────────────── */

static bool test_hmac_sha256(void)
{
    uint8_t mac[SHA256_DIGEST_SIZE];

    uint32_t t0 = k_uptime_get_32();
    uint32_t ret = hmac_sha256(kHmacKey, sizeof(kHmacKey),
                               kHmacData, sizeof(kHmacData),
                               mac);
    uint32_t hmac_ms = k_uptime_get_32() - t0;

    if (ret != 0) {
        return false;
    }

    if (memcmp(mac, kHmacExpected, SHA256_DIGEST_SIZE) != 0) {
        print_hex("got ", mac, SHA256_DIGEST_SIZE);
        print_hex("want", kHmacExpected, SHA256_DIGEST_SIZE);
        return false;
    }

    return true;
}

#endif /* CONFIG_RT583_CRYPTO_SELFTEST */

/* ── Public entry point ───────────────────────────────────────────────────── */

void crypto_selftest(void)
{
#ifdef CONFIG_RT583_CRYPTO_SELFTEST

    bool aes_ecb_ok  = test_aes128_ecb();
    bool aes_cbc_ok  = test_aes128_cbc();
    test_sha256();  /* wires ROM pointers; raw KAT skipped (ROM limitation) */
    bool hmac_ok     = test_hmac_sha256();

    bool all_ok = aes_ecb_ok && aes_cbc_ok && hmac_ok;
#elif defined(CONFIG_SOC_SERIES_RT583)
    /* Self-test disabled — just wire SHA-256 ROM pointers (required for HMAC). */
    sha256_vector_init();
#else
    /* rt584: SHA-256 served by mbedTLS PSA backend; no ROM wiring needed. */
#endif
}
```

## src/ZclCallbacks.cpp
```c
/*
 * RT583 Matter Lighting App — ZCL cluster attribute change callbacks.
 *
 * Called by the Matter stack when a controller writes to the OnOff or
 * LevelControl cluster attributes.  Routes changes to AppTask which
 * applies them to the hardware LED.
 */

#include "AppTask.h"

#include <app-common/zap-generated/attributes/Accessors.h>
#include <app-common/zap-generated/ids/Attributes.h>
#include <app-common/zap-generated/ids/Clusters.h>
#include <app/ConcreteAttributePath.h>
#include <lib/support/logging/CHIPLogging.h>
#include <zephyr/sys/printk.h>

using namespace chip;
using namespace chip::app::Clusters;
using namespace chip::app::Clusters::OnOff;

/* ── Attribute change callback ──────────────────────────────────────────────── */

void MatterPostAttributeChangeCallback(const chip::app::ConcreteAttributePath & path,
                                       uint8_t type, uint16_t size, uint8_t * value)
{
    /* Use printk directly — ChipLogProgress(Zcl, ...) is compiled out when
     * Zcl module logging is disabled in this build, leaving the callback
     * effectively empty and silent. printk always prints regardless of
     * Matter log filter config. */
    printk("[ZCL] AttrChange ep=%u cluster=0x%04x attr=0x%04x type=%u size=%u val=%u\n",
           path.mEndpointId, (unsigned) path.mClusterId,
           (unsigned) path.mAttributeId, type, size,
           (size > 0 && value) ? *value : 0);

    if (path.mClusterId == OnOff::Id &&
        path.mAttributeId == OnOff::Attributes::OnOff::Id)
    {
        printk("[ZCL] OnOff -> %u\n", *value);
        AppTask::Instance().SetLightOn(*value != 0);
    }
    else if (path.mClusterId == LevelControl::Id &&
             path.mAttributeId == LevelControl::Attributes::CurrentLevel::Id)
    {
        printk("[ZCL] Level -> %u\n", *value);
        if (AppTask::Instance().IsLightOn()) {
            AppTask::Instance().SetLightLevel(*value);
        }
    }
}

/* ── OnOff cluster init callback ────────────────────────────────────────────── */

void emberAfOnOffClusterInitCallback(EndpointId endpoint)
{
    /* Restore persisted on/off state from settings */
    Protocols::InteractionModel::Status status;
    bool storedValue = false;

    status = Attributes::OnOff::Get(endpoint, &storedValue);
    if (status == Protocols::InteractionModel::Status::Success) {
        AppTask::Instance().SetLightOn(storedValue);
    }
}
```
