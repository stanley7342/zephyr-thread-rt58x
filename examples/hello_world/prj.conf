## CMakeLists.txt
```
cmake_minimum_required(VERSION 3.20.0)

get_filename_component(RT583_PROJECT_DIR "${CMAKE_CURRENT_LIST_DIR}/../.." ABSOLUTE)

set(BOARD_ROOT   ${RT583_PROJECT_DIR})
set(SOC_ROOT     ${RT583_PROJECT_DIR})
set(DTS_ROOT     ${RT583_PROJECT_DIR})
set(KCONFIG_ROOT ${RT583_PROJECT_DIR}/Kconfig)

list(APPEND ZEPHYR_EXTRA_MODULES ${RT583_PROJECT_DIR})

find_package(Zephyr REQUIRED HINTS $ENV{ZEPHYR_BASE})
project(rt583_hello_world VERSION 1.0.0)

target_sources(app PRIVATE src/main.c)
```

## prj.conf
```kconfig
# Hello World — shared by rt583_evb and rt584_evb.
#
# UART driver (CONFIG_UART_RT583 / CONFIG_UART_RT584) and flash driver
# (CONFIG_FLASH_RT583 / CONFIG_FLASH_RT584) default to y on their respective
# SoC series, so they don't need explicit selection here.

# Console
CONFIG_SERIAL=y
CONFIG_CONSOLE=y
CONFIG_UART_CONSOLE=y
CONFIG_PRINTK=y

# MCUboot integration (Single-app mode — sysbuild.conf has
# SB_CONFIG_MCUBOOT_MODE_SINGLE_APP=y so only slot0 is built/flashed.
# No slot1 variant, no Direct-XIP secondary image.)
CONFIG_BOOTLOADER_MCUBOOT=y
CONFIG_MCUBOOT_GENERATE_UNSIGNED_IMAGE=y
CONFIG_MCUBOOT_IMGTOOL_SIGN_VERSION="1.0.0"
CONFIG_FLASH=y
CONFIG_FLASH_PAGE_LAYOUT=y
CONFIG_FLASH_MAP=y
```

## src/main.c
```c
#include <zephyr/kernel.h>

int main(void)
{
	printk("Hello World! %s\n", CONFIG_BOARD);

	while (1) {
		k_msleep(1000);
		printk("Hello World!\n");
	}

	return 0;
}
```
