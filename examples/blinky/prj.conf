## CMakeLists.txt
```
cmake_minimum_required(VERSION 3.20.0)

get_filename_component(RT583_PROJECT_DIR "${CMAKE_CURRENT_LIST_DIR}/../.." ABSOLUTE)

set(BOARD_ROOT   ${RT583_PROJECT_DIR})
set(SOC_ROOT     ${RT583_PROJECT_DIR})
set(DTS_ROOT     ${RT583_PROJECT_DIR})
set(KCONFIG_ROOT ${RT583_PROJECT_DIR}/Kconfig)

list(APPEND ZEPHYR_EXTRA_MODULES ${RT583_PROJECT_DIR})

find_package(Zephyr REQUIRED HINTS $ENV{ZEPHYR_BASE})
project(rt583_blinky VERSION 1.0.0)

target_sources(app PRIVATE src/main.c)
```

## sysbuild.conf
```
SB_CONFIG_BOOTLOADER_MCUBOOT=y
SB_CONFIG_MCUBOOT_MODE_DIRECT_XIP=y
SB_CONFIG_BOOT_SIGNATURE_TYPE_NONE=y
```

## prj.conf
```kconfig
# RT583-EVB LED Blinky

CONFIG_SERIAL=y
CONFIG_CONSOLE=y
CONFIG_UART_CONSOLE=y
CONFIG_UART_RT583=y
CONFIG_PRINTK=y

# MCUboot integration (Direct XIP)
CONFIG_BOOTLOADER_MCUBOOT=y
CONFIG_MCUBOOT_BOOTLOADER_MODE_DIRECT_XIP=y
CONFIG_MCUBOOT_GENERATE_UNSIGNED_IMAGE=y
CONFIG_MCUBOOT_IMGTOOL_SIGN_VERSION="1.0.0"
CONFIG_FLASH=y
CONFIG_FLASH_RT583=y
CONFIG_FLASH_PAGE_LAYOUT=y
CONFIG_FLASH_MAP=y
```

## src/main.c
```c
/*
 * RT583-EVB LED Blinky
 *
 * LED pin: GPIO22 (default — adjust to match your EVB schematic)
 */

#include <zephyr/kernel.h>
#include "gpio.h"

#define LED_PIN  22
#define BLINK_MS 500

int main(void)
{
	printk("RT583 Blinky — LED on GPIO%d\n", LED_PIN);

	gpio_cfg_output(LED_PIN);
	gpio_pin_write(LED_PIN, 0);

	while (1) {
		gpio_pin_toggle(LED_PIN);
		k_msleep(BLINK_MS);
	}

	return 0;
}
```
