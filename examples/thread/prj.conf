## CMakeLists.txt
```
cmake_minimum_required(VERSION 3.20.0)

# Project root lives two levels above this example (examples/thread/ → repo root).
get_filename_component(RT583_PROJECT_DIR "${CMAKE_CURRENT_LIST_DIR}/../.." ABSOLUTE)

set(BOARD_ROOT   ${RT583_PROJECT_DIR})
set(SOC_ROOT     ${RT583_PROJECT_DIR})
set(DTS_ROOT     ${RT583_PROJECT_DIR})
set(KCONFIG_ROOT ${RT583_PROJECT_DIR}/Kconfig)

# Register the project root as a Zephyr module so that cmake/zephyr_module/
# CMakeLists.txt is included at the correct point in Zephyr's build graph.
# That module contributes all SoC-aware platform sources, include dirs,
# and driver wiring — example stays SoC-agnostic.
list(APPEND ZEPHYR_EXTRA_MODULES ${RT583_PROJECT_DIR})

find_package(Zephyr REQUIRED HINTS $ENV{ZEPHYR_BASE})
project(rafael_ot_ftd_cli VERSION 1.0.0)

target_sources(app PRIVATE src/main.c)
target_include_directories(app PRIVATE ${CMAKE_CURRENT_LIST_DIR}/src)

# Increase OT task stack from default 4 KB to 8 KB — CLI command processing
# (otCliInputLine → version/state/dataset handlers) can consume 3-4 KB of stack
# on top of the base OT FTD loop frame, overflowing the 4 KB default.
target_compile_definitions(app PRIVATE CONFIG_OPENTHREAD_TASK_SIZE=8192)

if(CONFIG_OTA)
    target_sources(app PRIVATE src/ota_app.c)
    include(${RT583_PROJECT_DIR}/subsys/ota/CMakeLists.txt)
endif()

# OpenThread subsystem (SDK port) — pulls in the SDK OT core + Rafael
# port glue. Sets up app's OT/LMAC/HOSAL include paths internally.
if(CONFIG_OPENTHREAD_RT583 OR CONFIG_OPENTHREAD_RT584)
    set(RAFAEL_SDK ${RT583_PROJECT_DIR}/sdk)
    include(${RT583_PROJECT_DIR}/subsys/openthread/CMakeLists.txt)
endif()

# OT's bundled mbedTLS 3.6 overlaps with Zephyr's TF-PSA-Crypto 4.0 for
# platform.c / cipher.c / constant_time.c / psa_util.c — these MUST use OT's
# 3.6 copies because OT code is compiled against 3.6 headers (struct layouts
# differ between 3.6 and 4.0; mixing causes mbedtls_cipher_free to deref
# ctx_free_func at the wrong offset).  libapp.a precedes libtfpsacrypto.a in
# link order, so OT's 3.6 .o files win when this flag is set.
zephyr_ld_options(-Wl,--allow-multiple-definition)
```

## sysbuild.conf
```
SB_CONFIG_BOOTLOADER_MCUBOOT=y
SB_CONFIG_MCUBOOT_MODE_DIRECT_XIP=y
# Real signature verification — MCUboot rejects images whose ED25519
# signature doesn't validate against the trusted public key bundled
# at boot. Uses MCUboot's stock dev key (root-ed25519.pem) for now;
# production must replace this with a project-owned key.
SB_CONFIG_BOOT_SIGNATURE_TYPE_ED25519=y
```

## prj.conf
```kconfig
# Rafael (rt583/rt584) OpenThread FTD CLI — board-neutral common config.
# SoC-specific selectors live in boards/<board>.conf.
# UART/FLASH driver Kconfigs auto-default to y on their matching SoC series.

CONFIG_SERIAL=y
CONFIG_CONSOLE=y
CONFIG_UART_CONSOLE=y
CONFIG_UART_INTERRUPT_DRIVEN=y

CONFIG_PRINTK=y
CONFIG_THREAD_NAME=y

CONFIG_PICOLIBC=y
CONFIG_HEAP_MEM_POOL_SIZE=32768

CONFIG_MAIN_STACK_SIZE=2048

CONFIG_CPP=y
CONFIG_STD_CPP14=y

# Shell disabled — competes with printk on UART TX causing corrupted output
# CONFIG_SHELL=y

# OPENTHREAD=y enables the OPENTHREAD_IMPLEMENTATION choice context, so the
# board overlay can pick OPENTHREAD_RT583 / OPENTHREAD_RT584. Without this,
# OPENTHREAD_SOURCES=y would build Zephyr's upstream OT from modules/.
# OPENTHREAD_SYS_INIT=n prevents Zephyr from calling openthread_init()
# during system init — this example initializes OT manually via ot_zephyr.c.
CONFIG_OPENTHREAD=y
CONFIG_OPENTHREAD_SYS_INIT=n

# Path B: Zephyr's modules/openthread/platform/radio.c drives the
# ieee802154_rafael driver via the standard ieee802154_radio_api.
# Replaces the legacy sdk/openthread_port/Src/ot_radio.c path which
# overrode otPlatRadio* directly over lmac15p4. ot_radio.c's overrides
# are conditionally compiled out and Zephyr's radio.c is left in the
# openthread_platform target (cmake/zephyr_module strip respects this
# flag). Set =n to fall back to the legacy path.
CONFIG_IEEE802154_RAFAEL_FULL=y

# Path B requires Zephyr's networking + L2 OpenThread layer so that the
# ieee802154_radio_api callbacks are wired into otPlatRadio*. The legacy
# path skips this stack entirely.
CONFIG_NETWORKING=y
CONFIG_NET_L2_OPENTHREAD=y
CONFIG_NET_PKT_RX_COUNT=16
CONFIG_NET_PKT_TX_COUNT=16
CONFIG_NET_BUF_RX_COUNT=32
CONFIG_NET_BUF_TX_COUNT=32

CONFIG_CRC=y

CONFIG_ISR_STACK_SIZE=2048

CONFIG_SYSTEM_WORKQUEUE_STACK_SIZE=2048

# Flash subsystem (driver auto-selects via Kconfig default per SoC)
CONFIG_FLASH=y
CONFIG_FLASH_PAGE_LAYOUT=y
CONFIG_FLASH_MAP=y

# MCUboot integration — sysbuild propagates the chosen mode (Direct XIP /
# Single-app) and signature type (ED25519) from sysbuild.conf via
# .config.sysbuild, so no per-board CONFIG_MCUBOOT_BOOTLOADER_MODE_*
# or signature-key override is needed here. Image is signed with the
# stock dev key (bootloader/mcuboot/root-ed25519.pem); production
# must override SB_CONFIG_BOOT_SIGNATURE_KEY_FILE with a project key.
CONFIG_BOOTLOADER_MCUBOOT=y
# Image version embedded in MCUboot header (shown in boot log).
# Direct-XIP picks the slot with the higher version on every boot; build
# number tie-breaker enabled in sysbuild/mcuboot/prj.conf.
CONFIG_MCUBOOT_IMGTOOL_SIGN_VERSION="1.0.0"

# OTA subsystem (CoAP Block-wise + LZ4 decompress)
CONFIG_REBOOT=y
CONFIG_OTA=y
CONFIG_OTA_CURRENT_VERSION_MAJOR=1
CONFIG_OTA_CURRENT_VERSION_MINOR=0
CONFIG_OTA_CURRENT_VERSION_PATCH=0
CONFIG_SETTINGS=y
CONFIG_SETTINGS_NVS=y
CONFIG_NVS=y
```

## boards/rt583_evb.conf
```kconfig
# rt583-specific OT + MCUboot mode
CONFIG_OPENTHREAD_RT583=y
CONFIG_MCUBOOT_BOOTLOADER_MODE_DIRECT_XIP=y
```

## boards/rt584_evb.conf
```kconfig
# rt584-specific OT.
# MCUboot Single-app mode is set in sysbuild.conf for rt584 (no Direct XIP
# variant of slot1 is built); thread example currently uses Direct XIP for
# rt583 OTA — see CLAUDE.md / RT584 bring-up memory for the layout split.
CONFIG_OPENTHREAD_RT584=y
```

## src/main.c
```c
/*
 * main.c — OpenThread FTD CLI example (rt583_evb / rt584_evb).
 *
 * Build:
 *   west build --sysbuild -p always -b rt583_evb examples/thread -d build/thread583
 *   west build --sysbuild -p always -b rt584_evb examples/thread -d build/thread584
 *
 * Flash:
 *   west flash -d build/thread583   # or build/thread584
 *
 * RULE: Never call printk from a k_timer expiry or any ISR.
 * k_timer expiry runs in SysTick ISR context. printk holds a spinlock;
 * on a single-core Cortex-M3 this causes deadlock if main thread is
 * also inside printk when the ISR fires. Use k_work_submit instead.
 */

#include <zephyr/kernel.h>
#include <zephyr/irq.h>
#include <zephyr/sys/printk.h>
#include <zephyr/sys/crc.h>
#include "tprintk.h"

#include <openthread/cli.h>
#include <openthread/instance.h>

#include "openthread_port.h"
#if defined(CONFIG_OTA)
#include "ota_app.h"
#endif
#include "hosal_rf.h"
#include "lmac15p4.h"

/* RF firmware blob — integrity verified before loading */
extern const uint8_t  firmware_program_ruci[];
extern const uint32_t firmware_size_ruci;

/* ── Watchdog thread (independent of system workqueue) ───────────────────── */
#define WDOG_STACK_SIZE 1024
K_THREAD_STACK_DEFINE(wdog_stack, WDOG_STACK_SIZE);
static struct k_thread wdog_thread_data;

static void wdog_thread_fn(void *p1, void *p2, void *p3)
{
    ARG_UNUSED(p1); ARG_UNUSED(p2); ARG_UNUSED(p3);
    while (1) {
        k_msleep(1000);
    }
}

/* PHY/MAC PIB — tunable via Kconfig (prj.conf CONFIG_RT583_*_PIB_*) */
#define PHY_PIB_TURNAROUND_TIMER          CONFIG_RT583_PHY_PIB_TURNAROUND_TIMER
#define PHY_PIB_CCA_DETECTED_TIME         CONFIG_RT583_PHY_PIB_CCA_DETECTED_TIME
#define PHY_PIB_CCA_DETECT_MODE           CONFIG_RT583_PHY_PIB_CCA_DETECT_MODE
#define PHY_PIB_CCA_THRESHOLD             CONFIG_RT583_PHY_PIB_CCA_THRESHOLD
#define MAC_PIB_UNIT_BACKOFF_PERIOD       CONFIG_RT583_MAC_PIB_UNIT_BACKOFF_PERIOD
#define MAC_PIB_MAC_ACK_WAIT_DURATION     CONFIG_RT583_MAC_PIB_ACK_WAIT_DURATION
#define MAC_PIB_MAC_MAX_BE                CONFIG_RT583_MAC_PIB_MAX_BE
#define MAC_PIB_MAC_MAX_FRAME_TOTAL_WAIT_TIME CONFIG_RT583_MAC_PIB_MAX_FRAME_TOTAL_WAIT_TIME
#define MAC_PIB_MAC_MAX_FRAME_RETRIES     CONFIG_RT583_MAC_PIB_MAX_FRAME_RETRIES
#define MAC_PIB_MAC_MAX_CSMACA_BACKOFFS   CONFIG_RT583_MAC_PIB_MAX_CSMACA_BACKOFFS
#define MAC_PIB_MAC_MIN_BE                CONFIG_RT583_MAC_PIB_MIN_BE

void otrInitUser(otInstance *instance)
{
    otAppCliInit(instance);
#if defined(CONFIG_OTA)
    ota_app_init(instance);
#endif
}

int main(void)
{
    (printk)("======================================\n");
    (printk)("  %s  Zephyr + OpenThread CLI\n", CONFIG_BOARD);
    (printk)("  Built: " __DATE__ " " __TIME__ "\n");
    (printk)("======================================\n");

    k_thread_create(&wdog_thread_data, wdog_stack, K_THREAD_STACK_SIZEOF(wdog_stack),
                    wdog_thread_fn, NULL, NULL, NULL,
                    2, 0, K_NO_WAIT);
    k_thread_name_set(&wdog_thread_data, "wdog");

    /* Verify RF firmware blob integrity before loading */
    if (firmware_size_ruci > 0) {
        uint32_t fw_crc = crc32_ieee(firmware_program_ruci, firmware_size_ruci);
        printk("[RF] firmware CRC32: 0x%08x (size=%u)", fw_crc, firmware_size_ruci);
#if CONFIG_RT583_RF_FW_EXPECTED_CRC32 != 0
        if (fw_crc != CONFIG_RT583_RF_FW_EXPECTED_CRC32) {
            printk("[RF] ERROR: firmware CRC mismatch! expected=0x%08x",
                   CONFIG_RT583_RF_FW_EXPECTED_CRC32);
        }
#endif
    }

#if !defined(CONFIG_IEEE802154_RAFAEL_FULL)
    /* Path A: ot_radio.c owns the radio via lmac15p4 and otPlatRadio*
     * overrides; main() must bring up the RF MCU before otrStart(). */
    printk("[RF] hosal_rf_init...");
    hosal_rf_init(HOSAL_RF_MODE_RUCI_CMD);
    irq_enable(20);
    printk("[RF] hosal_rf_init done");

    printk("[RF] lmac15p4_init...");
    lmac15p4_init(LMAC15P4_2P4G_OQPSK, 0);
    printk("[RF] lmac15p4_init done");

    lmac15p4_phy_pib_set(PHY_PIB_TURNAROUND_TIMER, PHY_PIB_CCA_DETECT_MODE,
                         PHY_PIB_CCA_THRESHOLD, PHY_PIB_CCA_DETECTED_TIME);
    lmac15p4_mac_pib_set(MAC_PIB_UNIT_BACKOFF_PERIOD,
                         MAC_PIB_MAC_ACK_WAIT_DURATION, MAC_PIB_MAC_MAX_BE,
                         MAC_PIB_MAC_MAX_CSMACA_BACKOFFS,
                         MAC_PIB_MAC_MAX_FRAME_TOTAL_WAIT_TIME,
                         MAC_PIB_MAC_MAX_FRAME_RETRIES, MAC_PIB_MAC_MIN_BE);
#else
    /* Path B: ieee802154_rafael driver init runs at POST_KERNEL prio 80
     * and owns hosal_rf_init / lmac15p4_init / PIB. */
#endif

    otrStart();
    printk("OpenThread FTD CLI started.");

    return 0;
}
```

## src/ota_app.c
```c
/*
 * ota_app.c — OTA integration for RT583 Thread example
 *
 * Usage (OpenThread CLI):
 *   ota check  fd00::1              ← check + download from server fd00::1
 *   ota apply                       ← decompress staging → slot1 + reboot
 *   ota status                      ← show current OTA state
 *   ota confirm                     ← mark running image as healthy
 */

#include <zephyr/kernel.h>
#include <zephyr/sys/printk.h>
#include <zephyr/sys/reboot.h>
#include <string.h>

#include <openthread/cli.h>
#include <openthread/instance.h>
#include <openthread/ip6.h>

#include "ota.h"

/* ── Apply thread (decompression is CPU-heavy, run outside OT task) ───── */
#define APPLY_STACK_SIZE   CONFIG_OTA_APPLY_THREAD_STACK_SIZE
K_THREAD_STACK_DEFINE(ota_apply_stack, APPLY_STACK_SIZE);
static struct k_thread ota_apply_thread;
static ota_meta_t      pending_meta;
static bool            apply_pending;

static void apply_thread_fn(void *p1, void *p2, void *p3)
{
    ARG_UNUSED(p1); ARG_UNUSED(p2); ARG_UNUSED(p3);

    while (1) {
        k_sleep(K_SECONDS(1));
        if (!apply_pending) continue;

        apply_pending = false;
        printk("[OTA-App] starting decompress + apply\n");

        int rc = ota_flash_apply(&pending_meta);
        if (rc == OTA_OK) {
            printk("[OTA-App] apply OK — rebooting in 3 s\n");
            k_sleep(K_SECONDS(3));
            sys_reboot(SYS_REBOOT_COLD);
        } else {
            printk("[OTA-App] apply failed: %d\n", rc);
        }
    }
}

/* ── Download callback (runs in OT task context) ─────────────────────── */
static void on_download_done(int result, const ota_meta_t *meta)
{
    if (result != OTA_OK) {
        printk("[OTA-App] download failed: %d\n", result);
        return;
    }

    printk("[OTA-App] download OK — queuing apply\n");
    pending_meta  = *meta;
    apply_pending = true;
}

/* ── CLI command: ota <check|apply|status|confirm> [addr] ────────────── */
static otError cmd_ota(void *ctx, uint8_t argc, char *argv[])
{
    ARG_UNUSED(ctx);

    if (argc < 2) {
        otCliOutputFormat("usage: ota <check|apply|status|confirm> [server_addr]\r\n");
        return OT_ERROR_NONE;
    }

    if (strcmp(argv[1], "check") == 0) {
        if (argc < 3) {
            otCliOutputFormat("usage: ota check <server_ipv6_addr>\r\n");
            return OT_ERROR_NONE;
        }

        otIp6Address addr;
        if (otIp6AddressFromString(argv[2], &addr) != OT_ERROR_NONE) {
            otCliOutputFormat("invalid address: %s\r\n", argv[2]);
            return OT_ERROR_NONE;
        }

        int rc = ota_check_and_download(&addr, CONFIG_OTA_COAP_PORT,
                                        on_download_done);
        if (rc == OTA_ERR_BUSY)
            otCliOutputFormat("OTA already in progress\r\n");
        else
            otCliOutputFormat("OTA check started → %s\r\n", argv[2]);

    } else if (strcmp(argv[1], "apply") == 0) {
        if (ota_state_get() != OTA_STATE_DOWNLOADING) {
            otCliOutputFormat("no staged image (state=%d)\r\n",
                              ota_state_get());
            return OT_ERROR_NONE;
        }
        apply_pending = true;
        otCliOutputFormat("apply queued\r\n");

    } else if (strcmp(argv[1], "status") == 0) {
        static const char *state_str[] = {
            "IDLE", "DOWNLOADING", "DECOMPRESSING", "READY", "CONFIRMED"
        };
        ota_state_t st = ota_state_get();
        otCliOutputFormat("state: %s (%d)\r\n",
                          st < 5 ? state_str[st] : "?", st);
        otCliOutputFormat("staging: %u bytes written\r\n",
                          ota_staging_written());

    } else if (strcmp(argv[1], "confirm") == 0) {
        ota_confirm();
        otCliOutputFormat("confirmed\r\n");

    } else {
        otCliOutputFormat("unknown subcommand: %s\r\n", argv[1]);
    }

    return OT_ERROR_NONE;
}

static const otCliCommand kOtaCommand = { "ota", cmd_ota };

/* ── Init: call from otrInitUser() ──────────────────────────────────── */
void ota_app_init(otInstance *instance)
{
    ota_init(instance);

    k_thread_create(&ota_apply_thread, ota_apply_stack,
                    K_THREAD_STACK_SIZEOF(ota_apply_stack),
                    apply_thread_fn, NULL, NULL, NULL,
                    7, 0, K_NO_WAIT);
    k_thread_name_set(&ota_apply_thread, "ota_apply");

    otCliSetUserCommands(&kOtaCommand, 1, instance);
    printk("[OTA-App] ready\n");
}
```

## src/ota_app.h
```c
#ifndef OTA_APP_H
#define OTA_APP_H
#include <openthread/instance.h>
void ota_app_init(otInstance *instance);
#endif
```
