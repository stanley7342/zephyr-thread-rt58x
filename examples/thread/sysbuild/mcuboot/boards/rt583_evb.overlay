/*
 * RT583 partition resize for thread example.
 *
 * Default rt583.dtsi ships 800 KB slots + a 256 KB staging_partition.
 * Thread + OT + Matter need ~928 KB, so resize slot0/slot1 to 928 KB
 * each — slot1 then overlaps staging, so delete staging too. OTA flows
 * that need a staging area must add it back via an app-side overlay
 * at a different offset.
 *
 * Resulting layout (2 MB flash):
 *   0x000000 – 0x010000  boot_partition    64 KB  MCUboot
 *   0x010000 – 0x0F8000  slot0_partition  928 KB  primary app
 *   0x0F8000 – 0x1E0000  slot1_partition  928 KB  OTA / Direct-XIP failover
 *   0x1E0000 – 0x1F0000  storage_partition 64 KB  settings / NVS
 *   0x1F0000 – 0x200000  factory_partition 64 KB  factory data
 */

&slot0_partition {
    reg = <0x00010000 0x000E8000>;  /* 928 KB */
};

/delete-node/ &slot1_partition;

&flash0 {
    partitions {
        slot1_partition: partition@F8000 {
            label = "image-1";
            reg = <0x000F8000 0x000E8000>;  /* 928 KB — equal to slot0 */
        };
    };
};

/delete-node/ &staging_partition;
