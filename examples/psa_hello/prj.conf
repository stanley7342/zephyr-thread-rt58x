## CMakeLists.txt
```
cmake_minimum_required(VERSION 3.20.0)

get_filename_component(RT583_PROJECT_DIR "${CMAKE_CURRENT_LIST_DIR}/../.." ABSOLUTE)

set(BOARD_ROOT   ${RT583_PROJECT_DIR})
set(SOC_ROOT     ${RT583_PROJECT_DIR})
set(DTS_ROOT     ${RT583_PROJECT_DIR})
set(KCONFIG_ROOT ${RT583_PROJECT_DIR}/Kconfig)

list(APPEND ZEPHYR_EXTRA_MODULES ${RT583_PROJECT_DIR})

find_package(Zephyr REQUIRED HINTS $ENV{ZEPHYR_BASE})
project(rt58x_psa_hello VERSION 1.0.0)

target_sources(app PRIVATE src/main.c)

# rt584-only: pull in vendor otp.c so we can call rt_otp_read_data(PUF_UID,...).
# Demonstrates SG.1 (Unique Identification) — die-unique ID from the rt584
# PUF/OTP block, hashed with PSA Crypto into a 32-byte implementation ID.
if(CONFIG_SOC_SERIES_RT584)
    set(_RT584_DRV ${RT583_PROJECT_DIR}/sdk/components/platform/soc/rt584/rt584_driver)
    target_sources(app PRIVATE
        ${_RT584_DRV}/Src/otp.c
    )
    target_include_directories(app PRIVATE
        ${_RT584_DRV}/Inc
        ${RT583_PROJECT_DIR}/sdk/components/platform/include
    )
    target_compile_definitions(app PRIVATE PSA_HELLO_HAS_UID=1)
endif()
```

## prj.conf
```kconfig
# PSA Crypto hello-world — shared by rt583_evb and rt584_evb.
# Goal: bring up mbedTLS PSA Crypto without TF-M (no TZ isolation),
# demo psa_hash_compute on a known input, and verify against the
# expected SHA-256.

CONFIG_SERIAL=y
CONFIG_CONSOLE=y
CONFIG_UART_CONSOLE=y
CONFIG_PRINTK=y

# MCUboot integration — single-app mode (sysbuild.conf picks it).
CONFIG_BOOTLOADER_MCUBOOT=y
CONFIG_MCUBOOT_GENERATE_UNSIGNED_IMAGE=y
CONFIG_MCUBOOT_IMGTOOL_SIGN_VERSION="1.0.0"
CONFIG_FLASH=y
CONFIG_FLASH_PAGE_LAYOUT=y
CONFIG_FLASH_MAP=y

# PSA Crypto via mbedTLS — no TF-M; PSA API runs in-process.
CONFIG_MBEDTLS=y
CONFIG_MBEDTLS_PSA_CRYPTO_C=y
CONFIG_MBEDTLS_ENABLE_HEAP=y
CONFIG_MBEDTLS_HEAP_SIZE=16384

# Algorithms — SHA-256 for the hash demo + the cipher/MAC primitives
# the secure_storage AEAD transform needs (AES-128-GCM + HKDF-SHA-256
# for the per-entry key derivation).
CONFIG_PSA_WANT_ALG_SHA_256=y
CONFIG_PSA_WANT_ALG_GCM=y
CONFIG_PSA_WANT_ALG_HKDF=y
CONFIG_PSA_WANT_KEY_TYPE_AES=y
CONFIG_PSA_WANT_KEY_TYPE_HMAC=y
CONFIG_PSA_WANT_KEY_TYPE_RAW_DATA=y

# Entropy source: rt58x has no Zephyr entropy driver yet. Use the
# timer-based test generator so psa_crypto_init() succeeds. NOT
# cryptographically secure — fine for the hash demo (no key gen yet).
CONFIG_ENTROPY_GENERATOR=y
CONFIG_TEST_RANDOM_GENERATOR=y

# Heap for PSA internal buffers.
CONFIG_MAIN_STACK_SIZE=4096
CONFIG_HEAP_MEM_POOL_SIZE=8192

# PSA Internal Trusted Storage — settings-backed → NVS → storage_partition
# (64 KB at 0x1E0000 in rt584.dtsi). Power-cycle persists data; demonstrates
# SG.9 Secure Storage with real NV backing.
CONFIG_SECURE_STORAGE=y
CONFIG_SECURE_STORAGE_ITS_STORE_IMPLEMENTATION_SETTINGS=y
CONFIG_SETTINGS=y
CONFIG_SETTINGS_NVS=y
CONFIG_NVS=y

# Default secure_storage AEAD transform uses AES-256-GCM, but Zephyr's
# mbedTLS PSA Crypto rejects 32-byte AES keys (P2 psa-arch-tests proved
# this — 8 of 64 fails were all AES-256 NOT_SUPPORTED). Force the AEAD
# key size to 16 bytes (AES-128-GCM) so psa_its_set can encrypt entries.
CONFIG_SECURE_STORAGE_ITS_TRANSFORM_AEAD_KEY_SIZE=16
```

## src/main.c
```c
/*
 * PSA Crypto hello-world — rt583_evb / rt584_evb.
 *
 * Calls psa_hash_compute() with SHA-256 on the literal string "hello"
 * and verifies the result against the known good digest. This is the
 * minimum viable proof that mbedTLS PSA Crypto is wired up correctly
 * on rt58x — pre-requisite for running ARM's psa-arch-tests suite.
 */

#include <psa/crypto.h>
#include <psa/internal_trusted_storage.h>
#include <zephyr/kernel.h>
#include <zephyr/sys/printk.h>

/* PSA ITS demo: a single 32-bit counter under a fixed UID. Each boot
 * we read it, increment, write back. Power-cycle persists across reboots
 * because settings/NVS lands in storage_partition. */
#define PSA_ITS_BOOT_COUNTER_UID  ((psa_storage_uid_t)0xC0DEC0DE)

#if defined(PSA_HELLO_HAS_UID)
/* rt584 vendor OTP read API.  PUF_UID = 0; cells are 4 bytes each;
 * we read 8 cells = 32 bytes (raw die-unique ID + ROM-burned chip-info). */
#include "pufs_rt_regs.h"
#define UID_CELLS  8
#define UID_BYTES  (UID_CELLS * 4)
#endif

/* SHA-256("hello") — well-known test vector. */
static const uint8_t expected_sha256[32] = {
    0x2c, 0xf2, 0x4d, 0xba, 0x5f, 0xb0, 0xa3, 0x0e,
    0x26, 0xe8, 0x3b, 0x2a, 0xc5, 0xb9, 0xe2, 0x9e,
    0x1b, 0x16, 0x1e, 0x5c, 0x1f, 0xa7, 0x42, 0x5e,
    0x73, 0x04, 0x33, 0x62, 0x93, 0x8b, 0x98, 0x24,
};

static void hexdump(const char *label, const uint8_t *buf, size_t len)
{
    printk("%s ", label);
    for (size_t i = 0; i < len; i++) {
        printk("%02x", buf[i]);
    }
    printk("\n");
}

int main(void)
{
    printk("=========================================\n");
    printk("  %s  PSA Crypto hello\n", CONFIG_BOARD);
    printk("=========================================\n");

    psa_status_t status = psa_crypto_init();
    if (status != PSA_SUCCESS) {
        printk("FAIL: psa_crypto_init -> %d\n", status);
        return 0;
    }
    printk("[PSA] init ok\n");

    const char *msg = "hello";
    uint8_t hash[PSA_HASH_LENGTH(PSA_ALG_SHA_256)];
    size_t hash_len = 0;

    status = psa_hash_compute(PSA_ALG_SHA_256,
                              (const uint8_t *)msg, strlen(msg),
                              hash, sizeof(hash), &hash_len);
    if (status != PSA_SUCCESS) {
        printk("FAIL: psa_hash_compute -> %d\n", status);
        return 0;
    }
    printk("[PSA] sha256(\"hello\") computed, len=%u\n", (unsigned)hash_len);

    hexdump("  got     :", hash, hash_len);
    hexdump("  expected:", expected_sha256, sizeof(expected_sha256));

    if (hash_len == sizeof(expected_sha256) &&
        memcmp(hash, expected_sha256, hash_len) == 0) {
        printk("[PSA] PASS\n");
    } else {
        printk("[PSA] FAIL — digest mismatch\n");
    }

    /* SG.9 Secure Storage demo: PSA ITS NV-backed boot counter.
     * First boot prints "boot=1", subsequent boots monotonically increase,
     * proving the storage_partition NVS backing actually persists.
     *
     * Use psa_its_get_info() to disambiguate "UID doesn't exist yet" from
     * other errors — Zephyr's secure_storage returns -135 INVALID_ARGUMENT
     * (not -141 DOES_NOT_EXIST) when the entry is missing in some configs,
     * so checking via _get_info is more portable. */
    {
        uint32_t boot_count = 0;
        struct psa_storage_info_t info = {0};
        psa_status_t s = psa_its_get_info(PSA_ITS_BOOT_COUNTER_UID, &info);

        if (s == PSA_SUCCESS && info.size == sizeof(boot_count)) {
            size_t got = 0;
            s = psa_its_get(PSA_ITS_BOOT_COUNTER_UID, 0,
                            sizeof(boot_count), &boot_count, &got);
            if (s != PSA_SUCCESS) {
                printk("[ITS] FAIL: psa_its_get -> %d\n", s);
                goto its_done;
            }
            printk("[ITS] read boot_count=%u (got %u bytes)\n",
                   (unsigned)boot_count, (unsigned)got);
        } else {
            printk("[ITS] first boot — UID 0x%x not present (info -> %d)\n",
                   PSA_ITS_BOOT_COUNTER_UID, s);
            boot_count = 0;
        }

        boot_count++;
        s = psa_its_set(PSA_ITS_BOOT_COUNTER_UID, sizeof(boot_count),
                        &boot_count, PSA_STORAGE_FLAG_NONE);
        if (s != PSA_SUCCESS) {
            printk("[ITS] FAIL: psa_its_set -> %d\n", s);
            goto its_done;
        }
        printk("[ITS] wrote boot_count=%u — power-cycle to verify persistence\n",
               (unsigned)boot_count);
its_done:
        ;
    }

#if defined(PSA_HELLO_HAS_UID)
    /* SG.1 Unique Identification demo: read die-unique ID from rt584 PUF
     * block, derive a 32-byte PSA implementation_id by hashing it. This
     * is the canonical pattern for PSA Initial Attestation's
     * "implementation ID" claim — burning the per-device fingerprint
     * into a fixed-length value the attestation token can carry. */
    uint32_t uid_words[UID_CELLS] = {0};
    uint32_t rc = rt_otp_read_data(PUF_UID, 0, uid_words, UID_CELLS);
    if (rc != 0) {
        printk("[UID] FAIL: rt_otp_read_data -> %u\n", (unsigned)rc);
    } else {
        hexdump("[UID] raw  :", (const uint8_t *)uid_words, UID_BYTES);

        uint8_t impl_id[PSA_HASH_LENGTH(PSA_ALG_SHA_256)];
        size_t impl_id_len = 0;
        status = psa_hash_compute(PSA_ALG_SHA_256,
                                  (const uint8_t *)uid_words, UID_BYTES,
                                  impl_id, sizeof(impl_id), &impl_id_len);
        if (status == PSA_SUCCESS) {
            hexdump("[UID] hash :", impl_id, impl_id_len);
            printk("[UID] PSA implementation_id derived OK (%u bytes)\n",
                   (unsigned)impl_id_len);
        } else {
            printk("[UID] FAIL: psa_hash_compute(uid) -> %d\n", status);
        }
    }
#endif

    while (1) {
        k_msleep(1000);
    }
    return 0;
}
```
