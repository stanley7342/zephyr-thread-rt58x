/*
 * Device tree for Rafael RT584 EVB
 */

/dts-v1/;
#include <arm/rafael/rt584.dtsi>

/ {
    model = "Rafael Microelectronics RT584 EVB";
    compatible = "rafael,rt584-evb", "rafael,rt584";

    chosen {
        zephyr,sram             = &sram0;
        zephyr,flash            = &flash0;
        zephyr,flash-controller = &flash_controller;
        zephyr,console          = &uart0;
        zephyr,shell-uart       = &uart0;
        zephyr,code-partition   = &slot0_partition;
        zephyr,entropy          = &trng;
        zephyr,bt-hci           = &bt_hci_rt584;
        zephyr,ieee802154       = &ieee802154_rt584;
    };
};

&bt_hci_rt584 {
    status = "okay";
};
