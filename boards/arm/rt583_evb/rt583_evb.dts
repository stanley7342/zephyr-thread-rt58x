/*
 * Device tree for Rafael RT583 EVB
 */

/dts-v1/;
#include <arm/rafael/rt583.dtsi>

/ {
    model = "Rafael Microelectronics RT583 EVB";
    compatible = "rafael,rt583-evb", "rafael,rt583";

    chosen {
        zephyr,sram             = &sram0;
        zephyr,flash            = &flash0;
        zephyr,flash-controller = &flash_controller;
        zephyr,console          = &uart0;
        zephyr,shell-uart       = &uart0;
        zephyr,code-partition   = &slot0_partition;
        zephyr,bt-hci           = &bt_hci_rt583;
        zephyr,ieee802154       = &ieee802154_rt583;
        zephyr,entropy          = &trng;
    };
};

&bt_hci_rt583 {
    status = "okay";
};
