## boards/arm/rt582_evb/Kconfig.board
```kconfig
config BOARD_RT582_EVB
    bool "Rafael Microelectronics RT582 EVB"
    depends on SOC_RT582
```

## boards/arm/rt582_evb/Kconfig.defconfig
```kconfig
if BOARD_RT582_EVB

config BOARD
    default "rt582_evb"

endif # BOARD_RT582_EVB
```

## boards/arm/rt582_evb/board.yml
```yaml
board:
  name: rt582_evb
  full_name: Rafael Microelectronics RT582 EVB
  vendor: rafael
  socs:
  - name: rt582
```

## boards/arm/rt582_evb/rt582_evb_defconfig
```kconfig
# Zephyr sets SOC_RT582 automatically via board.yml / soc.yml.
# Only set application-level configs here.

# Console via UART0 (GPIO16=TX, GPIO17=RX, 115200 baud)
CONFIG_SERIAL=y
CONFIG_UART_CONSOLE=y
CONFIG_UART_RT582=y
```

## boards/arm/rt583_evb/Kconfig.board
```kconfig
config BOARD_RT583_EVB
    bool "Rafael Microelectronics RT583 EVB"
    depends on SOC_RT583
```

## boards/arm/rt583_evb/Kconfig.defconfig
```kconfig
if BOARD_RT583_EVB

config BOARD
    default "rt583_evb"

endif # BOARD_RT583_EVB
```

## boards/arm/rt583_evb/board.yml
```yaml
board:
  name: rt583_evb
  full_name: Rafael Microelectronics RT583 EVB
  vendor: rafael
  socs:
  - name: rt583
```

## boards/arm/rt583_evb/rt583_evb_defconfig
```kconfig
# Zephyr sets SOC_RT583 automatically via board.yml / soc.yml.
# Only set application-level configs here.

# Console via UART0 (GPIO16=TX, GPIO17=RX, 115200 baud)
CONFIG_SERIAL=y
CONFIG_UART_CONSOLE=y
CONFIG_UART_RT583=y

# Entropy subsystem — required for ENTROPY_RT583 (TRNG driver) and BLE/OT CSPRNG
CONFIG_ENTROPY_GENERATOR=y

# Generate Intel HEX for all apps — required by west flash (openocd runner hex mode).
# Address is embedded in the hex file so this works for both 0x0 and MCUboot (0x10000).
CONFIG_BUILD_OUTPUT_HEX=y
```

## boards/arm/rt584_evb/Kconfig.board
```kconfig
config BOARD_RT584_EVB
    bool "Rafael Microelectronics RT584 EVB"
    depends on SOC_RT584
```

## boards/arm/rt584_evb/Kconfig.defconfig
```kconfig
if BOARD_RT584_EVB

config BOARD
    default "rt584_evb"

endif # BOARD_RT584_EVB
```

## boards/arm/rt584_evb/board.yml
```yaml
board:
  name: rt584_evb
  full_name: Rafael Microelectronics RT584 EVB
  vendor: rafael
  socs:
  - name: rt584
```

## boards/arm/rt584_evb/rt584_evb_defconfig
```kconfig
# Zephyr sets SOC_RT584 automatically via board.yml / soc.yml.
# Only set application-level configs here.

# Console via UART0 (GPIO17=TX, GPIO16=RX, 115200 baud)
CONFIG_SERIAL=y
CONFIG_UART_CONSOLE=y
CONFIG_UART_RT584=y

# Generate Intel HEX — convenient for openocd flash loading.
CONFIG_BUILD_OUTPUT_HEX=y
```

## drivers/bluetooth/Kconfig
```kconfig
config BLE_RT583
	bool "Rafael RT583 BLE HCI driver"
	depends on BT
	help
	  Enable the Rafael RT583 integrated BLE controller HCI driver.
	  Bridges the HOSAL RF interface to Zephyr's BLE host stack via
	  shared-memory queues on the COMM_SUBSYSTEM co-processor.
```

## drivers/entropy/Kconfig
```kconfig
# SPDX-License-Identifier: Apache-2.0

config ENTROPY_RT583
	bool "Rafael RT583 hardware TRNG entropy driver"
	default y
	depends on DT_HAS_RAFAEL_RT583_TRNG_ENABLED && ENTROPY_GENERATOR
	select ENTROPY_HAS_DRIVER
	help
	  Enable the RT583 TRNG-based hardware entropy driver.
	  Requires ENTROPY_GENERATOR=y (set in board defconfig).
	  Selects ENTROPY_HAS_DRIVER to signal a real entropy source is present,
	  enabling CSPRNG_ENABLED for BLE and OpenThread.

config ENTROPY_RT584
	bool "Rafael RT584 hardware TRNG entropy driver"
	default y
	depends on DT_HAS_RAFAEL_RT584_TRNG_ENABLED && ENTROPY_GENERATOR
	select ENTROPY_HAS_DRIVER
	help
	  Enable the RT584 TRNG-based hardware entropy driver.
	  Requires ENTROPY_GENERATOR=y (set in board defconfig).
	  Selects ENTROPY_HAS_DRIVER so mbedTLS PSA can seed its DRBG and
	  CSPRNG_ENABLED is set (required by Matter psa_crypto_init).
```

## drivers/flash/Kconfig
```kconfig
config FLASH_RT583
    bool "Rafael RT583 internal flash driver"
    depends on SOC_SERIES_RT583
    select FLASH_HAS_DRIVER_ENABLED
    select FLASH_HAS_PAGE_LAYOUT
    default y
    help
      Flash driver for Rafael RT583 internal SPI flash.
      Wraps the HOSAL/flashctl API into Zephyr flash_driver_api.
      Supports 4KB sector erase and 256-byte page writes.

config FLASH_RT584
    bool "Rafael RT584 internal flash driver"
    depends on SOC_SERIES_RT584
    select FLASH_HAS_DRIVER_ENABLED
    select FLASH_HAS_PAGE_LAYOUT
    default y
    help
      Flash driver for Rafael RT584 internal SPI flash (Cortex-M33).
      Wraps the flashctl API into Zephyr flash_driver_api. Same
      granularity as RT583 (4 KB sector, 256-byte page).
```

## drivers/ieee802154/Kconfig
```kconfig
# SPDX-License-Identifier: Apache-2.0

config IEEE802154_RAFAEL
	bool "Rafael RT58x IEEE 802.15.4 radio driver"
	default y
	depends on DT_HAS_RAFAEL_RT583_IEEE802154_ENABLED || \
	           DT_HAS_RAFAEL_RT584_IEEE802154_ENABLED
	help
	  IEEE 802.15.4 radio driver for Rafael RT58x SoCs (rt583 / rt584).
	  By default a compile-time stub (see IEEE802154_RAFAEL_FULL for the
	  real driver). The stub provides a DTS device node so that Zephyr's
	  OpenThread platform (radio.c) can resolve DT_CHOSEN(zephyr_ieee802154);
	  real radio operation is then handled directly by ot_radio.c /
	  lmac15p4.

config IEEE802154_RAFAEL_INIT_PRIORITY
	int "Rafael IEEE 802.15.4 driver init priority"
	default 80
	depends on IEEE802154_RAFAEL

config IEEE802154_RAFAEL_FULL
	bool "Full Rafael IEEE 802.15.4 driver (replaces ot_radio.c otPlat* path)"
	default n
	depends on IEEE802154_RAFAEL
	select NET_L2_IEEE802154
	help
	  Implements the full Zephyr ieee802154_radio_api on top of lmac15p4
	  so that Zephyr's modules/openthread/platform/radio.c drives the
	  RT58x radio via the standard driver API (net_pkt based TX/RX, proper
	  L2 integration). When disabled (default), the legacy path in
	  ot_radio.c provides otPlatRadio* directly via lmac15p4 and this
	  driver remains a compile-time stub.

	  Enable this only when refactoring away from the legacy path —
	  requires simultaneously removing the otPlatRadio* overrides in
	  ot_radio.c and unstripping radio.c / memory.c in
	  cmake/zephyr_module/CMakeLists.txt.
```

## drivers/serial/Kconfig
```kconfig
config UART_RT583
    bool "Rafael RT583 UART driver"
    depends on SERIAL && SOC_SERIES_RT583
    select SERIAL_HAS_DRIVER
    select SERIAL_SUPPORT_INTERRUPT
    default y
    help
      UART driver for Rafael RT583. Wraps the HOSAL UART layer.
```

## dts/bindings/ieee802154/rafael,rt583-ieee802154.yaml
```yaml
description: Rafael RT583 IEEE 802.15.4 radio stub binding.
  Provides a DTS device node so that Zephyr's openthread/platform/radio.c
  can resolve DT_CHOSEN(zephyr_ieee802154) at compile time. The actual
  radio access is performed by ot_radio.c via the lmac15p4 library.

compatible: "rafael,rt583-ieee802154"

include: base.yaml
```

## dts/bindings/ieee802154/rafael,rt584-ieee802154.yaml
```yaml
description: Rafael RT584 IEEE 802.15.4 radio binding.
  Provides a DTS device node so that Zephyr's openthread/platform/radio.c
  can resolve DT_CHOSEN(zephyr_ieee802154) at compile time. The actual
  radio access is performed by ot_radio.c via the lmac15p4 library, or
  by drivers/ieee802154/ieee802154_rafael.c when CONFIG_IEEE802154_RAFAEL_FULL=y.

compatible: "rafael,rt584-ieee802154"

include: base.yaml
```

## dts/bindings/misc/rafael,rt583-trng.yaml
```yaml
description: Rafael RT583 True Random Number Generator (TRNG)

compatible: "rafael,rt583-trng"

include: base.yaml
```

## dts/bindings/misc/rafael,rt584-trng.yaml
```yaml
description: Rafael RT584 True Random Number Generator (TRNG)

compatible: "rafael,rt584-trng"

include: base.yaml
```

## dts/bindings/serial/rafael,rt582-uart.yaml
```yaml
description: Rafael RT582 UART controller

compatible: "rafael,rt582-uart"

include: [uart-controller.yaml]

properties:
  reg:
    required: true

  interrupts:
    required: true

  current-speed:
    required: true

  uart-id:
    type: int
    required: true
    description: |
      Hardware UART index (0 = UART0, 1 = UART1, 2 = UART2).
      Matches hosal_uart_id_t in the Rafael SDK.

  tx-pin:
    type: int
    description: GPIO pin number used for UART TX

  rx-pin:
    type: int
    description: GPIO pin number used for UART RX
```
