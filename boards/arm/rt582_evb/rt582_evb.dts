/*
 * Device tree for Rafael RT582 EVB
 */

/dts-v1/;
#include <arm/rafael/rt582.dtsi>

/ {
    model = "Rafael Microelectronics RT582 EVB";
    compatible = "rafael,rt582-evb", "rafael,rt582";

    chosen {
        zephyr,sram             = &sram0;
        zephyr,flash            = &flash0;
        zephyr,flash-controller = &flash_controller;
        zephyr,console          = &uart0;
        zephyr,shell-uart       = &uart0;
        zephyr,code-partition   = &slot0_partition;
    };
};
